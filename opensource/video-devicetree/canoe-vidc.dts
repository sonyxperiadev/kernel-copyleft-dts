// SPDX-License-Identifier: BSD-3-Clause
/*
 * Copyright (c) 2024-2025 Qualcomm Innovation Center, Inc. All rights reserved.
 */

/dts-v1/;
/plugin/;

#include <dt-bindings/interrupt-controller/arm-gic.h>
#include <dt-bindings/clock/qcom,gcc-canoe.h>
#include <dt-bindings/interconnect/qcom,canoe.h>
#include <dt-bindings/clock/qcom,videocc-canoe.h>
#include "canoe-vidc.dtsi"

/ {
	model = "Qualcomm Technologies, Inc. Canoe";
	compatible = "qcom,canoe";
	qcom,msm-id = <0x1000294 0x10000>, <0x1000295 0x10000>,
		<660 0x10000>, <661 0x10000>, <704 0x10000>,
		<0x10002C0 0x10000>;
	qcom,board-id = <0 0>;
};
