// SPDX-License-Identifier: BSD-3-Clause
/*
 * Copyright (c) 2024 Qualcomm Innovation Center, Inc. All rights reserved.
 */

/dts-v1/;
/plugin/;

#include <dt-bindings/interrupt-controller/arm-gic.h>
#include <dt-bindings/clock/qcom,gcc-blair.h>
#include <dt-bindings/interconnect/qcom,blair.h>
#include <dt-bindings/clock/qcom,gpucc-blair.h>
#include "blair-vidc.dtsi"

/ {
	model = "Qualcomm Technologies, Inc. Blair SoC";
	compatible = "qcom,blair";
	qcom,msm-id = <507 0x10000>, <565 0x10000>, <578 0x10000>;
	qcom,board-id = <0 0>;
};
