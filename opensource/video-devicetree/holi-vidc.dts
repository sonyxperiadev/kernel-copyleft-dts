// SPDX-License-Identifier: BSD-3-Clause
/*
 * Copyright (c) 2024 Qualcomm Innovation Center, Inc. All rights reserved.
 */

/dts-v1/;
/plugin/;

#include <dt-bindings/interrupt-controller/arm-gic.h>
#include <dt-bindings/clock/qcom,gcc-holi.h>
#include <dt-bindings/interconnect/qcom,holi.h>
#include <dt-bindings/clock/qcom,gpucc-holi.h>
#include "blair-vidc.dtsi"

/ {
	model = "Qualcomm Technologies, Inc. Blair SoC";
	compatible = "qcom,holi";
	qcom,msm-id = <454 0x10000>, <472 0x10000>;
	qcom,board-id = <0 0>;
};
