// SPDX-License-Identifier: BSD-3-Clause
/*
 * Copyright (c) 2024 Qualcomm Innovation Center, Inc. All rights reserved.
 */

/dts-v1/;
/plugin/;

#include <dt-bindings/interrupt-controller/arm-gic.h>
#include <dt-bindings/clock/qcom,sm4450-gcc.h>
#include <dt-bindings/clock/qcom,sm4450-gpucc.h>
#include <dt-bindings/interconnect/qcom,ravelin.h>
#include "ravelin-vidc.dtsi"

/ {
	model = "Qualcomm Technologies, Inc. Ravelin SoC";
	compatible = "qcom,ravelin";
	qcom,msm-id = <568 0x10000>, <602 0x10000>, <581 0x10000>, <582 0x10000>;
	qcom,board-id = <0 0>, <0 0x600>, <0 0x601>;
};
