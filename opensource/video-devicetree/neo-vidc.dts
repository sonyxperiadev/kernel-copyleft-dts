// SPDX-License-Identifier: BSD-3-Clause
/*
 * Copyright (c) 2024 Qualcomm Innovation Center, Inc. All rights reserved.
 */

/dts-v1/;
/plugin/;

#include <dt-bindings/interrupt-controller/arm-gic.h>
#include <dt-bindings/clock/qcom,gcc-neo.h>
#include <dt-bindings/interconnect/qcom,neo.h>
#include <dt-bindings/clock/qcom,videocc-neo.h>
#include "neo-vidc.dtsi"

/ {
	model = "Qualcomm Technologies, Inc. NEO v1 SoC";
	compatible = "qcom,neo";
	qcom,msm-id = <554 0x10000>, <579 0x10000>;
	qcom,board-id = <34 1>, <34 3>;
};
