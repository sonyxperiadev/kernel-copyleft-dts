/dts-v1/;
/plugin/;

#include <dt-bindings/clock/qcom,aop-qmp.h>
#include <dt-bindings/clock/qcom,gcc-parrot.h>
#include <dt-bindings/clock/qcom,gpucc-parrot.h>
#include <dt-bindings/clock/qcom,rpmh.h>
#include <dt-bindings/interconnect/qcom,parrot.h>
#include <dt-bindings/interrupt-controller/arm-gic.h>
#include <dt-bindings/regulator/qcom,rpmh-regulator-levels.h>

#include "parrot-gpu.dtsi"
#include "parrot-gpu-pwrlevels.dtsi"
/ {
	model = "Qualcomm Technologies, Inc. Parrot SG";
	compatible = "qcom,parrot";
	qcom,msm-id =  <633 0x10000>;
	qcom,board-id = <0 0>;
};

&msm_gpu {
	/delete-property/qcom,gpu-model;
	qcom,gpu-model = "AdrenoA21v1";
};
