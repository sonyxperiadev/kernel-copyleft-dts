// SPDX-License-Identifier: BSD-3-Clause
/*
 * Copyright (c) 2025 Qualcomm Innovation Center, Inc. All rights reserved.
 */

#include "canoe-gpu.dtsi"

&msm_gpu {
	compatible = "qcom,adreno-gpu-gen8-2-1", "qcom,kgsl-3d0";

	qcom,gpu-model = "Adreno840v2";

	qcom,chipid = <0x44050a01>;
};
