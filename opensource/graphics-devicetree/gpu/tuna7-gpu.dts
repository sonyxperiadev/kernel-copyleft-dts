// SPDX-License-Identifier: BSD-3-Clause
/*
 * Copyright (c) 2024 Qualcomm Innovation Center, Inc. All rights reserved.
 */

/dts-v1/;
/plugin/;

#include <dt-bindings/clock/qcom,aop-qmp.h>
#include <dt-bindings/clock/qcom,gcc-tuna.h>
#include <dt-bindings/clock/qcom,gpucc-tuna.h>
#include <dt-bindings/clock/qcom,rpmh.h>
#include <dt-bindings/interconnect/qcom,tuna.h>
#include <dt-bindings/interrupt-controller/arm-gic.h>
#include <dt-bindings/regulator/qcom,rpmh-regulator-levels.h>

#include "tuna-gpu.dtsi"
#include "tuna-gpu-pwrlevels.dtsi"

/ {
	model = "Qualcomm Technologies, Inc. tuna7 SoC";
	compatible = "qcom,tuna";
	qcom,msm-id = <0x2a9 0x10000>;
	qcom,board-id = <0 0>;
};

&msm_gpu {
	/delete-property/qcom,gpu-model;
        qcom,gpu-model = "Adreno822";
};
