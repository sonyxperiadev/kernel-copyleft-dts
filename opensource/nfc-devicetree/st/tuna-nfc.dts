// SPDX-License-Identifier: BSD-3-Clause

/*
 * Copyright (c) 2024 Qualcomm Innovation Center, Inc. All rights reserved.
 */

/dts-v1/;
/plugin/;

#include "tuna-nfc-common.dtsi"
/ {
        model = "Qualcomm Technologies, Inc. Tuna SoC";
        compatible = "qcom,tuna";
        qcom,msm-id = <681 0x10000>, <655 0x10000>, <694 0x10000>;
        qcom,board-id = <33 0>, <1 0>, <8 0>, <8 3>, <11 0>, <21 0>;
};
