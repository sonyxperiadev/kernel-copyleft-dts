// SPDX-License-Identifier: BSD-3-Clause

/*
 * Copyright (c) 2024 Qualcomm Innovation Center, Inc. All rights reserved.
 */

/dts-v1/;
/plugin/;

#include "kera-nfc-common.dtsi"
/ {
        model = "Qualcomm Technologies, Inc. Kera SoC";
        compatible = "qcom,kera";
        qcom,msm-id = <686 0x10000>, <659 0x10000>;
        qcom,board-id = <0x30008 0>, <0x30008 1>;
};
