//
/* Copyright (c) Qualcomm Technologies, Inc. and/or its subsidiaries.
 *  SPDX-License-Identifier: BSD-3-Clause
 */

/dts-v1/;
/plugin/;

#include "canoe-audio-mtp.dtsi"

&lpass_bt_swr {
	status = "disabled";
};

&canoe_snd {
	qcom,wcn-bt = <0>;
	qcom,wcn-bt-ext = <0>;
	qcom,msm_audio_ssr_devs = <&audio_gpr>, <&lpi_tlmm>,
                               <&lpass_cdc>;
};

 / {
	model = "Qualcomm Technologies, Inc. Canoe MTP";
	compatible = "qcom,canoe-mtp", "qcom,canoe", "qcom,mtp";
	qcom,msm-id = <660 0x10000>, <660 0x20000>, <661 0x10000>, <661 0x20000>,
		      <0x1000294 0x10000>, <0x1000294 0x20000>,
		      <0x1000295 0x10000>, <0x1000295 0x20000>,
		      <722 0x30000>, <723 0x30000>,
		      <743 0x10000>, <743 0x20000>;
	qcom,board-id = <0x70008 0>;
};
