/* Copyright (c) Qualcomm Technologies, Inc. and/or its subsidiaries.
 * SPDX-License-Identifier: BSD-3-Clause-Clear
*/
/dts-v1/;
/plugin/;

#include "parrot-lite-audio-idp.dtsi"

/ {
	model = "Qualcomm Technologies, Inc. Parrot-Lite IDP";
	compatible = "qcom,parrot-idp", "qcom,parrot", "qcom,idp";
	qcom,msm-id = <715 0x10000>;
	qcom,board-id = <34 0>, <34 0x600>, <34 1>, <34 0x601>, <34 3>, <34 0x603>,
			<34 4>, <34 0x604>, <34 2>, <34 0x602>, <34 5>;
};

