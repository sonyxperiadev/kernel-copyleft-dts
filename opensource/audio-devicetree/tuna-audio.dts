// SPDX-License-Identifier: BSD-3-Clause
/*
 * Copyright (c) 2024 Qualcomm Innovation Center, Inc. All rights reserved.
 */

/dts-v1/;
/plugin/;

#include <dt-bindings/clock/qcom,gcc-tuna.h>
#include <dt-bindings/interrupt-controller/arm-gic.h>
#include <dt-bindings/interconnect/qcom,tuna.h>
#include <dt-bindings/regulator/qcom,rpmh-regulator-levels.h>

#include "tuna-audio.dtsi"

/ {
	model = "Qualcomm Technologies, Inc. tuna";
	compatible = "qcom,tuna";
	qcom,msm-id = <681 0x10000>, <655 0x10000>, <694 0x10000>;
	qcom,board-id = <0 0>;
};
