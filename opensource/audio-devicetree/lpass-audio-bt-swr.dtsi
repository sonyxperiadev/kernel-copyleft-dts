//
/* Copyright (c) Qualcomm Technologies, Inc. and/or its subsidiaries.
 * SPDX-License-Identifier: BSD-3-Clause-Clear
 */

&spf_core_platform {
	bt_swr_gpios: bt_swr_clk_data_pinctrl {
		compatible = "qcom,msm-cdc-pinctrl";
		pinctrl-names = "aud_active", "aud_sleep";
		pinctrl-0 = <&qca_swr_clk_active &qca_swr_data_active>;
		pinctrl-1 = <&qca_swr_clk_sleep &qca_swr_data_sleep>;
		qcom,lpi-gpios;
		#gpio-cells = <0>;
	};
};

&lpass_bt_swr {
	compatible = "qcom,lpass-bt-swr";
	clock-names = "bt_swr_mclk_clk", "bt_swr_mclk_clk_2x",
			"lpass_core_hw_vote", "lpass_audio_hw_vote";
	clocks = <&clock_audio_bt_swr_mclk_clk 0>,
		<&clock_audio_bt_swr_mclk_clk_2x 0>,
		<&lpass_core_hw_vote 0>,
		<&lpass_audio_hw_vote 0>;
	qcom,bt-swr-gpios = <&bt_swr_gpios>;
};

&swr4 {
	compatible = "qcom,swr-mstr";
	qcom,swr_master_id = <5>;
	clock-names = "lpass_core_hw_vote",
			"lpass_audio_hw_vote";
	clocks = <&lpass_core_hw_vote 0>,
			<&lpass_audio_hw_vote 0>;
	interrupt-names = "swr_master_irq";
	qcom,swr-num-ports = <7>;
	qcom,swr-port-mapping = <1 BT_AUDIO_RX1 0x3>,
		<2 BT_AUDIO_RX2 0x3>, <3 BT_AUDIO_RX3 0x3>,
		<5 BT_AUDIO_TX1 0x3>, <6 BT_AUDIO_TX2 0x3>,
		<7 BT_AUDIO_TX3 0x3>, <8 FM_AUDIO_TX1 0x3>;
	qcom,swr-num-dev = <1>;
};
