// SPDX-License-Identifier: BSD-3-Clause
/*
 * Copyright (c) 2024 Qualcomm Innovation Center, Inc. All rights reserved.
 */

/dts-v1/;
/plugin/;

#include "tuna-wcn7750-bt.dtsi"

/ {
	model = "Qualcomm Technologies, Inc. Tuna";
	compatible = "qcom,tuna-rcm", "qcom,tunap-rcm", "qcom,rcm",
				 "qcom,tuna-mtp", "qcom,tunap-mtp", "qcom,mtp",
				 "qcom,tuna-cdp", "qcom,tunap-cdp", "qcom,cdp",
				 "qcom,tuna-qrd", "qcom,tunap-qrd", "qcom,qrd",
				 "qcom,tuna", "qcom,tunap";
	qcom,msm-id = <681 0x10000>, <655 0x10000>, <694 0x10000>;
	qcom,board-id = <1 0>, <8 0>, <8 1>, <8 4>, <11 0>, <21 0>;
};
