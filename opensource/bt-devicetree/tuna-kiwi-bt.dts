// SPDX-License-Identifier: BSD-3-Clause
/*
 * Copyright (c) 2024 Qualcomm Innovation Center, Inc. All rights reserved.
 */

/dts-v1/;
/plugin/;

#include "tuna-kiwi-bt.dtsi"

/ {
	model = "Qualcomm Technologies, Inc. Tuna";
	compatible = "qcom,tuna-rcm", "qcom,tunap-rcm", "qcom,rcm",
				 "qcom,tuna-mtp", "qcom,tunap-mtp", "qcom,mtp",
				 "qcom,tuna-atp", "qcom,tunap-atp", "qcom,atp",
				 "qcom,tuna", "qcom,tunap";
	qcom,msm-id = <681 0x10000>, <655 0x10000>, <694 0x10000>;
	qcom,board-id = <21 1>, <8 2>, <8 3>, <33 0>;
};
