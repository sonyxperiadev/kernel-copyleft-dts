// SPDX-License-Identifier: BSD-3-Clause
/*
 * Copyright (c) 2024 Qualcomm Innovation Center, Inc. All rights reserved.
 */

/dts-v1/;
/plugin/;

#include "kera-qca6750-bt.dtsi"

/ {
	model = "Qualcomm Technologies, Inc. Kera";
	compatible = "qcom,kera-atp", "qcom,kera", "qcom,atp",
				"qcom,kera-cdp", "qcom,cdp", "qcom,kera-mtp",
				"qcom,mtp", "qcom,kera-rcm", "qcom,rcm";
	qcom,msm-id = <686 0x10000>, <659 0x10000>;
	qcom,board-id = <0x000021 0>, <0x010001 0>, <0x020001 0>,
					<0x030001 0>, <0x040001 0>, <0x010008 0>,
					<0x020008 0>, <0x030008 0>, <0x010015 0>,
					<0x020015 0>, <0x030015 0>, <0x03000B 1>,
					<0x050001 0>;
};
