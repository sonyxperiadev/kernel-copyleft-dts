// SPDX-License-Identifier: BSD-3-Clause
/*
 * Copyright (c) 2024 Qualcomm Innovation Center, Inc. All rights reserved.
 */

/dts-v1/;
/plugin/;

#include "trustedvm-kera-sde.dtsi"
#include "trustedvm-kera-sde-display-mtp.dtsi"

/ {
	model = "Qualcomm Technologies, Inc. Kera SVM MTP";
	compatible = "qcom,kera-mtp", "qcom,kera", "qcom,kerap-mtp", "qcom,kerap",
			"qcom,mtp";
	qcom,msm-id = <686 0x10000>, <659 0x10000>;
	qcom,board-id = <0x10008 0>, <0x10008 1>, <0x20008 0>, <0x20008 1>, <0x30008 0>,
			<0x30008 1>;
};
