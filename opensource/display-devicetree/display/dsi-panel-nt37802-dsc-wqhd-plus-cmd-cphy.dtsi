// SPDX-License-Identifier: BSD-3-Clause
/*
 * Copyright (c) Qualcomm Technologies, Inc. and/or its subsidiaries.
 */

&mdss_mdp{
	dsi_nt37802_amoled_cmd_cphy: qcom,mdss_dsi_nt37802_wqhd_plus_cmd_cphy {
		qcom,mdss-dsi-panel-name =
			"nt37802 amoled cmd mode dsi csot panel with DSC CPHY";
		qcom,mdss-dsi-panel-type = "dsi_cmd_mode";
		qcom,mdss-dsi-panel-physical-type = "oled";
		qcom,mdss-dsi-virtual-channel-id = <0>;
		qcom,mdss-dsi-stream = <0>;
		qcom,mdss-dsi-bpp = <24>;

		qcom,dsi-ctrl-num = <0>;
		qcom,dsi-phy-num = <0>;

		qcom,mdss-dsi-traffic-mode = "non_burst_sync_event";
		qcom,mdss-dsi-lane-map = "lane_map_0123";
		qcom,mdss-dsi-bllp-eof-power-mode;
		qcom,mdss-dsi-bllp-power-mode;
		qcom,mdss-dsi-lane-0-state;
		qcom,mdss-dsi-lane-1-state;
		qcom,mdss-dsi-lane-2-state;
		qcom,mdss-dsi-dma-trigger = "trigger_sw";
		qcom,mdss-dsi-mdp-trigger = "none";
		qcom,mdss-dsi-reset-sequence = <1 10>, <0 10>, <1 10>;

		qcom,mdss-dsi-te-pin-select = <1>;
		qcom,mdss-dsi-wr-mem-start = <0x2c>;
		qcom,mdss-dsi-wr-mem-continue = <0x3c>;
		qcom,mdss-dsi-te-dcs-command = <1>;
		qcom,mdss-dsi-te-check-enable;
		qcom,mdss-dsi-te-using-te-pin;
		qcom,panel-cphy-mode;

		qcom_mdss_dsi_display_timings_351: qcom,mdss-dsi-display-timings {
			timing_0_352: timing@0 {
				cell-index = <0>;
				qcom,mdss-dsi-panel-framerate = <120>;
				qcom,mdss-dsi-panel-width = <1440>;
				qcom,mdss-dsi-panel-height = <3200>;
				qcom,mdss-dsi-h-front-porch = <32>;
				qcom,mdss-dsi-h-back-porch = <32>;
				qcom,mdss-dsi-h-pulse-width = <16>;
				qcom,mdss-dsi-v-back-porch = <48>;
				qcom,mdss-dsi-v-front-porch = <16>;
				qcom,mdss-dsi-v-pulse-width = <2>;
				qcom,mdss-dsi-h-sync-skew = <0>;
				qcom,mdss-dsi-h-left-border = <0>;
				qcom,mdss-dsi-h-right-border = <0>;
				qcom,mdss-dsi-v-top-border = <0>;
				qcom,mdss-dsi-v-bottom-border = <0>;

				qcom,mdss-dsi-on-command = [
					39 00 00 00 00 00 06 F0 55 AA 52 08 08
					39 00 00 00 00 00 17 C1 8E FF EE FF FF
					   EE FF FF EE FF FF EE FF FF EE FF FF
					   FF 7F FF 0E FF
					15 00 00 00 00 00 02 6F 20
					39 00 00 00 00 00 04 C1 3F FD FF
					15 00 00 00 00 00 02 6F 23
					39 00 00 00 00 00 15 C1 0E FF EE FF FF
					   EE FF FF EE FF FF EE FF FF EE FF FF
					   DF 7F 11
					39 00 00 00 00 00 05 2A 00 00 05 9F
					39 00 00 00 00 00 05 2B 00 00 0C 7F
					39 00 00 00 00 00 03 90 03 43
					39 00 00 00 00 00 13 91 AB A8 00 14 C2
					   00 02 68 02 2E 00 0A 05 0E 03 D1 10
					   F0
					15 00 00 00 00 00 02 35 00
					39 00 00 00 00 00 03 51 0F FF
					15 00 00 00 00 00 02 6F 04
					39 00 00 00 00 00 03 51 0F FF
					15 00 00 00 00 00 02 53 20
					15 00 00 00 00 00 02 6F 01
					15 00 00 00 00 00 02 8B 00
					39 00 00 00 00 00 06 F0 55 AA 52 08 04
					15 00 00 00 00 00 02 C0 20
					39 00 00 00 00 00 04 8C 00 00 11
					39 00 00 00 00 00 05 FF AA 55 A5 81
					15 00 00 00 00 00 02 6F 21
					15 00 00 00 00 00 02 F5 03
					15 00 00 00 00 00 02 6F 43
					39 00 00 00 00 00 19 F5 01 02 01 04 00
					   01 02 00 00 00 43 02 00 00 10 00 00
					   10 05 00 11 31 12 11
					15 00 00 00 00 00 02 6F 1D
					39 00 00 00 00 00 04 FB 64 07 80
					15 00 00 00 00 00 02 6F 07
					15 00 00 00 00 00 02 FC 04
					39 00 00 00 00 00 06 F0 55 AA 52 08 01
					15 00 00 00 00 00 02 6F 02
					15 00 00 00 00 00 02 D6 03
					39 00 00 00 00 00 05 FF AA 55 A5 84
					15 00 00 00 00 00 02 6F 9A
					15 00 00 00 00 00 02 F3 0F
					15 00 00 00 00 00 02 6F 02
					15 00 00 00 00 00 02 2F 32
					39 00 00 00 00 00 06 F0 55 AA 52 08 03
					39 00 00 00 00 00 04 C8 01 FF FB
					39 00 00 00 00 00 05 FF AA 55 A5 80
					15 00 00 00 00 00 02 6F 22
					15 00 00 00 00 00 02 FE 06
					15 00 00 00 00 00 02 6D 00
					15 00 00 00 00 00 02 68 20
					39 00 00 00 00 00 06 F0 55 AA 52 08 00
					15 00 00 00 00 00 02 6F 31
					39 00 00 00 00 00 03 C0 01 00
					15 00 00 00 00 00 02 6F 35
					39 00 00 00 00 00 03 C0 23 20
					15 00 00 00 00 00 02 6F 01
					15 00 00 00 00 00 02 5F 40
					39 00 00 00 00 00 06 F0 55 AA 52 08 00
					15 00 00 00 00 00 02 6F 78
					39 00 00 00 00 00 18 B0 11 00 2A 00 C2
					   01 DA 03 7C 05 B1 08 80 0B EE 0F FF
					   05 55 05 56 05 55
					15 00 00 00 00 00 02 6F 6F
					39 00 00 00 00 00 07 B0 02 D0 05 A0 02
					   D0
					39 00 00 00 00 00 06 F0 55 AA 52 08 03
					15 00 00 00 00 00 02 6F 04
					15 00 00 00 00 00 02 C7 FD
					39 00 00 00 00 00 06 F0 55 AA 52 08 00
					15 00 00 00 00 00 02 C7 33
					39 00 00 00 00 00 0C A3 83 01 9B 01 9B
					   02 00 C0 09 09 00
					15 00 00 00 00 00 02 6F 53
					39 00 00 00 00 00 07 A3 02 00 C0 09 09
					   55
					39 00 00 00 00 00 06 F0 55 AA 52 08 00
					15 00 00 00 00 00 02 6F 10
					39 00 00 00 00 00 11 B5 00 71 71 71 71
					   71 00 00 11 29 00 00 00 11 29 00
					39 00 00 00 00 00 06 F0 55 AA 52 08 01
					15 00 00 00 00 00 02 6F 04
					15 00 00 00 00 00 02 B2 30
					05 00 00 00 78 00 01 11
					05 01 00 00 78 00 01 29
					0a 01 00 00 00 00 80 12 00 00 89 30 80
					   0c 80 05 a0 00 14 02 d0 02 d0 02 00
					   02 86 00 20 02 15 00 0a 00 0d 05 7a
					   03 d1 18 00 10 f0 03 0c 20 00 06 0b
					   0b 33 0e 1c 2a 38 46 54 62 69 70 77
					   79 7b 7d 7e 01 02 01 00 09 40 09 be
					   19 fc 19 fa 19 f8 1a 38 1a 78 1a b6
					   2a b6 2a f4 2a f4 4b 34 63 74 74 00
					   00 00 00 00 00 00 00 00 00 00 00 00
					   00 00 00 00 00 00 00 00 00 00 00 00
					   00 00 00 00 00 00 00 00 00 00 00 00
					   00 00
				];

				qcom,mdss-dsi-off-command = [
					05 00 00 00 0A 00 01 28
					05 00 00 00 78 00 01 10];
				qcom,mdss-dsi-on-command-state = "dsi_lp_mode";
				qcom,mdss-dsi-off-command-state = "dsi_hs_mode";
				qcom,mdss-dsi-timing-switch-command-state =
					"dsi_lp_mode";
				qcom,compression-mode = "dsc";
				qcom,mdss-dsc-version = <0x12>;
				qcom,mdss-dsc-slice-height = <20>;
				qcom,mdss-dsc-slice-width = <720>;
				qcom,mdss-dsc-slice-per-pkt = <1>;
				qcom,mdss-dsc-bit-per-component = <8>;
				qcom,mdss-dsc-bit-per-pixel = <8>;
				qcom,mdss-dsc-block-prediction-enable;
			};
		};
	};
};
