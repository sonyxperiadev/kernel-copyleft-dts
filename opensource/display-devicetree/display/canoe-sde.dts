// SPDX-License-Identifier: BSD-3-Clause
/*
 * Copyright (c) Qualcomm Technologies, Inc. and/or its subsidiaries.
 */

/dts-v1/;
/plugin/;

#include "canoe-sde.dtsi"

/ {
	model = "Qualcomm Technologies, Inc. Canoe";
	compatible = "qcom,canoe";
	qcom,msm-id = <0x10294 0x10000>, <0x10294 0x20000>, <0x10295 0x10000>, <0x10295 0x20000>,
			<0x30294 0x10000>, <0x30294 0x20000>, <0x30295 0x10000>, <0x30295 0x20000>,
			<0x1010294 0x10000>, <0x1010294 0x20000>, <0x1010295 0x10000>,
			<0x1010295 0x20000>, <0x1030294 0x10000>, <0x1030294 0x20000>,
			<0x1030295 0x10000>, <0x1030295 0x20000>, <0x294 0x10000>, <0x295 0x10000>,
			<0x295 0x20000>, <0x1000294 0x10000>, <0x1000294 0x20000>, <0x294 0x20000>,
			<722 0x30000>, <723 0x30000>,
			<743 0x10000>, <743 0x20000>;
	qcom,board-id = <0 0>;
};
