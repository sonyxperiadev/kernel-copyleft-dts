// SPDX-License-Identifier: BSD-3-Clause
/*
 * Copyright (c) 2024 Qualcomm Innovation Center, Inc. All rights reserved.
 */

#include "trustedvm-tuna-sde-display.dtsi"

&mdss_mdp {
    qcom,sde-emulated-env;
};
