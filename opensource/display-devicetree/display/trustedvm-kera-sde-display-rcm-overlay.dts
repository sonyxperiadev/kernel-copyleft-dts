// SPDX-License-Identifier: BSD-3-Clause
/*
 * Copyright (c) 2024 Qualcomm Innovation Center, Inc. All rights reserved.
 */

/dts-v1/;
/plugin/;

#include "trustedvm-kera-sde.dtsi"
#include "trustedvm-kera-sde-display-cdp.dtsi"

/ {
	model = "Qualcomm Technologies, Inc. Kera SVM RCM";
	compatible = "qcom,kera-rcm", "qcom,kera", "qcom,kerap-rcm", "qcom,kerap",
			"qcom,rcm";
	qcom,msm-id = <686 0x10000>, <659 0x10000>;
	qcom,board-id = <0x10015 0>, <0x10015 1>, <0x20015 0>, <0x20015 1>, <0x30015 0>,
			<0x30015 1>;
};
