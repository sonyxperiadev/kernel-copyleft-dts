// SPDX-License-Identifier: BSD-3-Clause
/*
 * Copyright (c) 2024 Qualcomm Innovation Center, Inc. All rights reserved.
 */

/dts-v1/;
/plugin/;

#include "trustedvm-tuna-sde.dtsi"
#include "trustedvm-tuna-sde-display-cdp.dtsi"

/ {
	model = "Qualcomm Technologies, Inc. Tuna SVM RCM";
	compatible = "qcom,tuna-rcm", "qcom,tuna", "qcom,tunap-rcm", "qcom,tunap",
			"qcom,rcm";
	qcom,msm-id = <681 0x10000>, <655 0x10000>, <694 0x10000>;
	qcom,board-id = <21 0>, <21 1>;
};
