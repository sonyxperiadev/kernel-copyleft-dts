// SPDX-License-Identifier: BSD-3-Clause
/*
 * Copyright (c) 2024 Qualcomm Innovation Center, Inc. All rights reserved.
 */

/dts-v1/;
/plugin/;

#include "kera-sde-display-mtp.dtsi"

/ {
	model = "Qualcomm Technologies, Inc. Kera ATP";
	compatible = "qcom,kera-atp", "qcom,kera", "qcom,kerap-atp", "qcom,kerap",
			"qcom,atp";
	qcom,msm-id = <686 0x10000>, <659 0x10000>;
	qcom,board-id = <33 0>;
};
