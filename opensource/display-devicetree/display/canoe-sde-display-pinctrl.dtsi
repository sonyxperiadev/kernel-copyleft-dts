// SPDX-License-Identifier: BSD-3-Clause
/*
 * Copyright (c) Qualcomm Technologies, Inc. and/or its subsidiaries.
 */
/*
* Copyright 2025 Sony Corporation
* NOTE: This file has been modified by Sony Corporation
* Modifications are licensed under the License.
*/

&pmd802x_gpios {
	sde_disp0_vdd_active: sde_disp0_vdd_active {
		pins = "gpio2";
		function = "normal";
		input-disable;
		output-enable;
		bias-disable;
		power-source = <2>;
		qcom,drive-strength = <2>;
	};
};

