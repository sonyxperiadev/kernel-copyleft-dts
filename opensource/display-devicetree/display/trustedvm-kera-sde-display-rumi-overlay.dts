// SPDX-License-Identifier: BSD-3-Clause
/*
 * Copyright (c) 2024 Qualcomm Innovation Center, Inc. All rights reserved.
 */

/dts-v1/;
/plugin/;

#include "trustedvm-kera-sde.dtsi"
#include "trustedvm-kera-sde-display-rumi.dtsi"

/ {
	model = "Qualcomm Technologies, Inc. Kera SVM RUMI";
	compatible = "qcom,kera-rumi", "qcom,kera", "qcom,rumi";
	qcom,msm-id = <659 0x10000>;
	qcom,board-id = <15 0>;
};
