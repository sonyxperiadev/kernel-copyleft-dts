// SPDX-License-Identifier: BSD-3-Clause
/*
 * Copyright (c) 2024 Qualcomm Innovation Center, Inc. All rights reserved.
 */

/dts-v1/;
/plugin/;

#include "trustedvm-tuna-sde.dtsi"
#include "trustedvm-tuna-sde-display-qrd.dtsi"

/ {
	model = "Qualcomm Technologies, Inc. Tuna SVM QRD";
	compatible = "qcom,tuna-qrd", "qcom,tuna", "qcom,tunap-qrd", "qcom,tunap",
			"qcom,qrd";
	qcom,msm-id = <681 0x10000>, <655 0x10000>, <694 0x10000>;
	qcom,board-id = <11 0>;
};
