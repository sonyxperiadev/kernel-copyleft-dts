// SPDX-License-Identifier: BSD-3-Clause
/*
 * Copyright (c) Qualcomm Technologies, Inc. and/or its subsidiaries.
 */

/dts-v1/;
/plugin/;

#include "canoe-sde-display-qrd.dtsi"

&sde_dp {
	qcom,dp-aux-switch = <&redriver>;
};

/ {
	model = "Qualcomm Technologies, Inc. Canoe QRD + ST54L + Kundu";
	compatible = "qcom,canoe-qrd", "qcom,canoe", "qcom,canoep-cdp", "qcom,canoep",
			   "qcom,qrd";
	qcom,msm-id = <660 0x10000>, <660 0x20000>, <661 0x10000>, <661 0x20000>,
		      <0x1000294 0x10000>, <0x1000294 0x20000>,
		      <0x1000295 0x10000>, <0x1000295 0x20000>,
		      <722 0x30000>, <723 0x30000>,
		      <743 0x10000>, <743 0x20000>;
	qcom,board-id = <11 0>;
};

&sde_dsi {
	vdd-supply = <&display_panel_vdd>;
};

&sde_dsi2 {
	vdd-supply = <&display_panel_vdd>;
};
