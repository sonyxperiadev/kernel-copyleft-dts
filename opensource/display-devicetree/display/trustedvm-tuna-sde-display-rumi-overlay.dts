// SPDX-License-Identifier: BSD-3-Clause
/*
 * Copyright (c) 2024 Qualcomm Innovation Center, Inc. All rights reserved.
 */

/dts-v1/;
/plugin/;

#include "trustedvm-tuna-sde.dtsi"
#include "trustedvm-tuna-sde-display-rumi.dtsi"

/ {
	model = "Qualcomm Technologies, Inc. Tuna SVM RUMI";
	compatible = "qcom,tuna-rumi", "qcom,tuna", "qcom,rumi";
	qcom,msm-id = <655 0x10000>, <694 0x10000>;
	qcom,board-id = <15 0>;
};
