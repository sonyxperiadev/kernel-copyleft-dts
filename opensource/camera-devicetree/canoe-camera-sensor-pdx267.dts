/dts-v1/;
/plugin/;

#include <dt-bindings/clock/qcom,gcc-canoe.h>
#include <dt-bindings/clock/qcom,camcc-canoe.h>
#include <dt-bindings/clock/qcom,cambistmclkcc-canoe.h>
#include <dt-bindings/interconnect/qcom,canoe.h>
#include <dt-bindings/interrupt-controller/arm-gic.h>
#include <dt-bindings/regulator/qcom,rpmh-regulator-levels.h>
#include <dt-bindings/clock/qcom,rpmh.h>

#include "canoe-camera-sensor-pdx267.dtsi"
/ {
	model = "Sony Corporation. PDX-267(canoe/honu QRD)";
	compatible = "somc,pdx256-generic", "qcom,canoe", "qcom,canoep";
	qcom,msm-id = <660 0x10000>, <660 0x20000>, <661 0x10000>,
		<661 0x20000>, <0x1000294 0x10000>, <0x1000294 0x20000>,
		<0x1000295 0x10000>, <0x1000295 0x20000>,<0x10294 0x10000>,
		<0x10294 0x20000>, <0x10295 0x10000>, <0x10295 0x20000>,
		<0x1010294 0x10000>, <0x1010294 0x20000>, <0x1010295 0x10000>,
		<0x1010295 0x20000>;
	qcom,board-id = <11 0>, <0x1000B 0>, <0x2000B 0>;
};
