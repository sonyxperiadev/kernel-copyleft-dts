// SPDX-License-Identifier: BSD-3-Clause
/*
 * Copyright (c) 2025 Qualcomm Innovation Center, Inc. All rights reserved.
 */

/dts-v1/;
/plugin/;

#include <dt-bindings/clock/qcom,camcc-canoe.h>
#include <dt-bindings/clock/qcom,videocc-canoe.h>
#include <dt-bindings/clock/qcom,evacc-canoe.h>
#include <dt-bindings/clock/qcom,dispcc-canoe.h>
#include "canoe-mmrm.dtsi"

/ {
	model = "Qualcomm Technologies, Inc. canoe SoC";
	compatible = "qcom,canoe";
	qcom,msm-id = <0x1000294 0x10000>, <0x1000295 0x10000>,
		<0x1000294 0x20000>, <0x1000295 0x20000>,
		<660 0x10000>, <661 0x10000>,
		<660 0x20000>, <661 0x20000>,
		<0x10002E7 0x10000>, <0x10002E7 0x20000>,
		<743 0x10000>, <743 0x20000>;
	qcom,board-id = <0 0>;
};
