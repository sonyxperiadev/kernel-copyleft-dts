/* Copyright (c) 2024 Qualcomm Innovation Center, Inc. All rights reserved.
 * SPDX-License-Identifier: BSD-3-Clause
 */
/dts-v1/;
/plugin/;

#include <dt-bindings/soc/qcom,ipcc.h>
#include <dt-bindings/interrupt-controller/arm-gic.h>
#include "tuna-synx.dtsi"

/ {
	model = "Qualcomm Technologies, Inc. tuna SoC";
	compatible = "qcom,tuna";
	qcom,msm-id = <655 0x10000>, <681 0x10000>, <694 0x10000>;
	qcom,board-id = <0 0>, <15 0>;
};