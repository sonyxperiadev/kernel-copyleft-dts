/* Copyright (c) 2024 Qualcomm Innovation Center, Inc. All rights reserved.
 * SPDX-License-Identifier: BSD-3-Clause
 */
/dts-v1/;
/plugin/;

#include <dt-bindings/mailbox/qcom-ipcc.h>
#include <dt-bindings/mailbox/qcom-ipcc-canoe.h>
#include <dt-bindings/interrupt-controller/arm-gic.h>
#include "canoe-synx.dtsi"

/ {
	model = "Qualcomm Technologies, Inc. Canoe SoC";
	compatible = "qcom,canoe";
	qcom,msm-id = <660 0x10000>, <660 0x20000>, <661 0x10000>, <661 0x20000>,
		      <0x1000294 0x10000>, <0x1000294 0x20000>,
		      <0x1000295 0x10000>, <0x1000295 0x20000>,
		      <704 0x10000>, <704 0x20000>,
		      <0x10002C0 0x10000>, <0x10002C0 0x20000>,
		      <685 0x10000>, <0x10002AD 0x10000>,
		      <727 0x10000>, <0x10002D7 0x10000>,
		      <722 0x30000>, <723 0x30000>,
		      <743 0x10000>, <743 0x20000>,
		      <0x10002E7 0x10000>, <0x10002E7 0x20000>;
	qcom,board-id = <0 0>;
};
