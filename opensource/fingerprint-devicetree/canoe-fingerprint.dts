// SPDX-License-Identifier: BSD-3-Clause
/*
 * Copyright (c) 2024 Qualcomm Innovation Center, Inc. All rights reserved.
 */

/dts-v1/;
/plugin/;

#include "canoe-fingerprint.dtsi"

/ {
	model = "Qualcomm Technologies, Inc. Sun SoC";
	compatible = "qcom,canoe";
	qcom,board-id = <0 0>;
	qcom,msm-id = <660 0x10000>, <660 0x20000>,
			<0x1000294 0x10000>, <00x1000294 0x20000>;
};
