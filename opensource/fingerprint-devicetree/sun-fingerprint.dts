// SPDX-License-Identifier: BSD-3-Clause
/*
 * Copyright (c) 2024 Qualcomm Innovation Center, Inc. All rights reserved.
 */

/dts-v1/;
/plugin/;

#include "sun-fingerprint.dtsi"

/ {
	model = "Qualcomm Technologies, Inc. Sun SoC";
	compatible = "qcom,sun";
	qcom,board-id = <0 0>;
	qcom,msm-id = <618 0x10000>, <618 0x20000>,
		      <0x100026a 0x10000>, <0x100026a 0x20000>;
};
