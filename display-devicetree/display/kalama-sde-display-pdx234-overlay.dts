/dts-v1/;
/plugin/;

#include "kalama-sde-display-qrd.dtsi"
#include "somc-yodo-display.dtsi"
#include "somc-yodo-display-pdx234.dtsi"

/ {
	model = "Sony Corporation. PDX234(Kalama QRD)";
	compatible = "somc,pdx234", "qcom,kalama", "qcom,qrd";
	qcom,msm-id = <519 0x10000>, <536 0x10000>, <519 0x20000>, <536 0x20000>;
	qcom,board-id = <0x1000B 0>;
};
