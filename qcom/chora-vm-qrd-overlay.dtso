// SPDX-License-Identifier: BSD-3-Clause
/*
 * Copyright (c) Qualcomm Technologies, Inc. and/or its subsidiaries.
 */
/dts-v1/;
/plugin/;

#include "chora-vm-avf.dtsi"
#include "chora-vm-qrd-avf.dtsi"

/ {
	model = "Qualcomm Technologies, Inc. Chora SVM QRD";
	compatible = "qcom,chora-qrd", "qcom,chora", "qcom,chorap-qrd", "qcom,chorap",
			   "qcom,qrd";
	qcom,board-id = <0x1000b 0x0>, <0x2000b 0x0>;

	host {
	};
};
