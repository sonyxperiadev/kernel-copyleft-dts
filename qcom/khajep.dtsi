// SPDX-License-Identifier: BSD-3-Clause
/*
 * Copyright (c) Qualcomm Technologies, Inc. and/or its subsidiaries.
 */

/dts-v1/;

#include "khaje.dtsi"

/ {
	model = "Qualcomm Technologies, Inc. Khajep SoC";
	compatible = "qcom,khajep";
	qcom,msm-id = <561 0x10000>;
};


&soc {

	qcom,rmnet-ipa {
		status = "disabled";
	};

};

&ipa_hw {
	status = "disabled";
};
