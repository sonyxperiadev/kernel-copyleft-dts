// SPDX-License-Identifier: BSD-3-Clause
/*
 * Copyright (c) Qualcomm Technologies, Inc. and/or its subsidiaries.
 */

/dts-v1/;
/plugin/;

#include "alor-rcm.dtsi"

/ {
	model = "Qualcomm Technologies, Inc. Alor RCM + WCN7750 WLAN + Kundu";
	compatible = "qcom,alor-rcm", "qcom,alor", "qcom,rcm", "qcom,alorp-rcm", "qcom,alorp";
	qcom,msm-id = <685 0x10000>, <727 0x10000>;
	qcom,board-id = <0x10015 0>;
};
