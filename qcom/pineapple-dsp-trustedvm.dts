/dts-v1/;
/plugin/;

#include "pineapple-dsp-trustedvm.dtsi"

/ {
	model = "Qualcomm Technologies, Inc. Pineapple - TrustedVM";
	compatible = "qcom,pineapple";
	qcom,msm-id = <557 0x10000>, <557 0x20000>, <577 0x10000>, <577 0x20000>, <614 0x10000>, <632 0x10000>;
};
