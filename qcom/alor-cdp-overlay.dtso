// SPDX-License-Identifier: BSD-3-Clause
/*
 * Copyright (c) Qualcomm Technologies, Inc. and/or its subsidiaries.
 */

/dts-v1/;
/plugin/;

#include "alor-cdp.dtsi"

/ {
	model = "Qualcomm Technologies, Inc. Alor CDP + WCN7750 WLAN + Kundu";
	compatible = "qcom,alor-cdp", "qcom,alor", "qcom,cdp", "qcom,alorp-cdp", "qcom,alorp";
	qcom,msm-id = <685 0x10000>, <727 0x10000>;
	qcom,board-id = <0x10001 0>;
};
