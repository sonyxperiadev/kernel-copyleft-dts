// SPDX-License-Identifier: BSD-3-Clause
/*
 * Copyright (c) Qualcomm Technologies, Inc. and/or its subsidiaries.
 */

#include "seraph-pmic-overlay.dtsi"
#include "seraph-thermal-overlay.dtsi"

&soc {
};
