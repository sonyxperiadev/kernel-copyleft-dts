// SPDX-License-Identifier: BSD-3-Clause
/*
 * Copyright (c) Qualcomm Technologies, Inc. and/or its subsidiaries.
 */

/dts-v1/;
/plugin/;

#include "malabar-qrd.dtsi"

/ {
	model = "Qualcomm Technologies, Inc. Malabar QRD";
	compatible = "qcom,malabar-qrd", "qcom,malabar", "qcom,malabarp-qrd", "qcom,malabarp",
			"qcom,qrd";
	qcom,msm-id = <733 0x10000>, <757 0x10000>;
	qcom,board-id = <0x1000b 0>;
};
