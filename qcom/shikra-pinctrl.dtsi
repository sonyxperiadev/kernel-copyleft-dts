// SPDX-License-Identifier: BSD-3-Clause
/*
 *Copyright (c) Qualcomm Technologies, Inc. and/or its subsidiaries.
 */

&soc {

	tlmm: pinctrl@0x500000 {
		compatible = "qcom,shikra-tlmm";
		reg = <0x500000 0x800000>;
		interrupts = <GIC_SPI 227 IRQ_TYPE_LEVEL_HIGH>;
		gpio-controller;
		#gpio-cells = <2>;
		interrupt-controller;
		#interrupt-cells = <2>;
	};
};
