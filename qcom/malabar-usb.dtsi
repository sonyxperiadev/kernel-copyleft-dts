// SPDX-License-Identifier: BSD-3-Clause
/*
 * Copyright (c) Qualcomm Technologies, Inc. and/or its subsidiaries.
 */

#include <dt-bindings/clock/qcom,malabar-gcc.h>

&soc {
	usb0: hsusb@4e00000 {
		compatible = "qcom,dwc-usb3-msm";
		reg = <0x4e00000 0x100000>;
		reg-names = "core_base";

		#address-cells = <1>;
		#size-cells = <1>;
		ranges;

		power-domains = <&gcc GCC_USB20_PRIM_GDSC>;
		clocks = <&gcc GCC_USB20_PRIM_MASTER_CLK>,
			<&gcc GCC_SYS_NOC_USB2_PRIM_AXI_CLK>,
			<&gcc GCC_CFG_NOC_USB2_PRIM_AXI_CLK>,
			<&gcc GCC_USB20_PRIM_MOCK_UTMI_CLK>,
			<&gcc GCC_USB20_PRIM_SLEEP_CLK>;
		clock-names = "core_clk", "iface_clk", "bus_aggr_clk",
					"utmi_clk", "sleep_clk";

		resets = <&gcc GCC_USB20_PRIM_BCR>;
		reset-names = "core_reset";

		interrupts-extended = <&intc GIC_SPI 223 IRQ_TYPE_LEVEL_HIGH>;
		interrupt-names = "pwr_event_irq";

		qcom,dis-sending-cm-l1-quirk;
		qcom,core-clk-rate = <66666667>;

		qcom,num-gsi-evt-buffs = <0x3>;
		qcom,gsi-reg-offset =
			<0x0fc /* GSI_GENERAL_CFG */
			0x110 /* GSI_DBL_ADDR_L */
			0x120 /* GSI_DBL_ADDR_H */
			0x130 /* GSI_RING_BASE_ADDR_L */
			0x144 /* GSI_RING_BASE_ADDR_H */
			0x1a4>; /* GSI_IF_STS */

		dwc3@4e00000 {
			compatible = "snps,dwc3";
			reg = <0x4e00000 0xe000>;

			interrupts = <GIC_SPI 157 IRQ_TYPE_LEVEL_HIGH>;
			snps,disable-clk-gating;
			snps,has-lpm-erratum;
			snps,hird-threshold = /bits/ 8 <0x0>;
			snps,is-utmi-l1-suspend;
			snps,dis-u1-entry-quirk;
			snps,dis-u2-entry-quirk;
			snps,dis_u2_susphy_quirk;
			snps,ssp-u3-u0-quirk;
			dr_mode = "otg";
			maximum-speed = "high-speed";
		};
	};
};
