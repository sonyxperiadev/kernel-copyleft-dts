// SPDX-License-Identifier: BSD-3-Clause
/*
 * Copyright (c) Qualcomm Technologies, Inc. and/or its subsidiaries.
 */

/dts-v1/;
/plugin/;

#include "alor-mtp-pmih010x-smb1398.dtsi"

/ {
	model = "Qualcomm Technologies, Inc. Alor MTP + Peach WLAN + PMIH010X SMB1398 + SN220U + Panderio";
	compatible = "qcom,alor-mtp", "qcom,alor", "qcom,mtp", "qcom,alorp-mtp", "qcom,alorp";
	qcom,msm-id = <685 0x10000>, <727 0x10000>;
	qcom,board-id = <0x30008 0>;
};
