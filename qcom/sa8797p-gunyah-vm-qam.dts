// SPDX-License-Identifier: BSD-3-Clause
/*
 * Copyright (c) Qualcomm Technologies, Inc. and/or its subsidiaries.
 */

/dts-v1/;

#include "sa8797p-gunyah-vm-qam.dtsi"

/ {
	model = "Qualcomm Technologies, Inc. SA8797p QAM Gunyah VM";
	compatible = "qcom,sa8797p", "qcom,qam";
	qcom,msm-id = <690 0x10000>, <690 0x10001>;
	qcom,board-id = <0x10025 0x0>;
};
