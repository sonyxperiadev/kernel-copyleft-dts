// SPDX-License-Identifier: BSD-3-Clause
/*
 * Copyright (c) Qualcomm Technologies, Inc. and/or its subsidiaries.
 */

#include <dt-bindings/clock/qcom,chora-gcc.h>

&soc {
	usb0: hsusb@a600000 {
		compatible = "qcom,dwc-usb3-msm";
		reg = <0x0 0xa600000 0x0 0x100000>;
		reg-names = "core_base";

		#address-cells = <2>;
		#size-cells = <2>;
		ranges;

		power-domains = <&gcc GCC_USB20_GDSC>;
		clocks = <&gcc GCC_USB20_MASTER_CLK>,
			<&gcc GCC_SYS_NOC_USB_SF_AXI_CLK>,
			<&gcc GCC_SNOC_CNOC_USB2_CLK>,
			<&gcc GCC_USB20_MOCK_UTMI_CLK>,
			<&gcc GCC_USB20_SLEEP_CLK>;
		clock-names = "core_clk", "iface_clk", "bus_aggr_clk",
					"utmi_clk", "sleep_clk";

		resets = <&gcc GCC_USB20_BCR>;
		reset-names = "core_reset";

		interrupts-extended = <&intc GIC_SPI 578 IRQ_TYPE_LEVEL_HIGH>;
		interrupt-names = "pwr_event_irq";

		qcom,dis-sending-cm-l1-quirk;
		qcom,core-clk-rate = <66666667>;

		qcom,num-gsi-evt-buffs = <0x3>;
		qcom,gsi-reg-offset =
			<0x0fc /* GSI_GENERAL_CFG */
			0x110 /* GSI_DBL_ADDR_L */
			0x120 /* GSI_DBL_ADDR_H */
			0x130 /* GSI_RING_BASE_ADDR_L */
			0x144 /* GSI_RING_BASE_ADDR_H */
			0x1a4>; /* GSI_IF_STS */

		dwc3_0: dwc3@a600000 {
			compatible = "snps,dwc3";
			reg = <0x0 0xa600000 0x0 0xe000>;

			iommus = <&apps_smmu 0x40 0x0>;
			qcom,iommu-dma = "atomic";
			memory-region = <&dwc3_mem_region>;
			dma-coherent;

			interrupts = <GIC_SPI 242 IRQ_TYPE_LEVEL_HIGH>;
			snps,disable-clk-gating;
			snps,has-lpm-erratum;
			snps,hird-threshold = /bits/ 8 <0x0>;
			snps,is-utmi-l1-suspend;
			snps,dis-u1-entry-quirk;
			snps,dis-u2-entry-quirk;
			snps,dis_u2_susphy_quirk;
			snps,ssp-u3-u0-quirk;
			dr_mode = "otg";
			maximum-speed = "high-speed";
			usb-role-switch;
		};
	};

	dwc3_mem_region: dwc3_mem_region {
		iommu-addresses = <&dwc3_0 0x0 0x0 0x0 0x90000000>,
					<&dwc3_0 0x0 0xf0000000 0xffffffff 0x10000000>;
	};
};
