/dts-v1/;
/plugin/;

#include "pineapple-audio.dtsi"
#include "pineapple-audio-qrd.dtsi"
#include "somc-asahi-audio-common.dtsi"
#include "somc-asahi-audio-pdx245.dtsi"
#include "somc-asahi-audio-j.dtsi"

/ {
	model = "Sony Corporation. PDX-245 J(Pineapple QRD)";
	compatible = "somc,pdx245-j", "qcom,pineapple", "qcom,qrd";
	qcom,msm-id = <557 0x10000>, <557 0x20000>, <577 0x10000>, <577 0x20000>;
	qcom,board-id = <0x1000B 0>, <0xB 0>;
};