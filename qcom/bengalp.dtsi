// SPDX-License-Identifier: BSD-3-Clause
/*
 * Copyright (c) Qualcomm Technologies, Inc. and/or its subsidiaries.
 */

/dts-v1/;

#include "bengal.dtsi"

/ {
	model = "Qualcomm Technologies, Inc. Bengalp SoC";
	compatible = "qcom,bengalp";
	qcom,msm-id = <445 0x10000>, <420 0x10000>;
};

&soc {
	qcom,rmnet-ipa {
		status = "disabled";
	};
};

&ipa_hw {
	status = "disabled";
};
