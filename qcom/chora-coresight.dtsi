// SPDX-License-Identifier: BSD-3-Clause
/*
 * Copyright (c) Qualcomm Technologies, Inc. and/or its subsidiaries.
 */

&soc {
	cti@10813000 {
		compatible = "arm,coresight-cti", "arm,primecell";
		reg = <0x0 0x10813000 0x0 0x1000>;

		arm,primecell-periphid = <0x000bb922>;
		device-name = "cti_mss2";

		status = "disabled";
		qcom,extended_cti;
		clocks = <&aoss_qmp>;
		clock-names = "apb_pclk";
	};

	cti@1080b000 {
		compatible = "arm,coresight-cti", "arm,primecell";
		reg = <0x0 0x1080b000 0x0 0x1000>;

		arm,primecell-periphid = <0x000bb922>;
		device-name = "cti_mss1";

		qcom,extended_cti;
		clocks = <&aoss_qmp>;
		clock-names = "apb_pclk";
	};

	cti@10802000 {
		compatible = "arm,coresight-cti", "arm,primecell";
		reg = <0x0 0x10802000 0x0 0x1000>;

		arm,primecell-periphid = <0x000bb922>;
		device-name = "cti_mss0";

		qcom,extended_cti;
		clocks = <&aoss_qmp>;
		clock-names = "apb_pclk";
	};

	cti@10cc5000 {
		compatible = "arm,coresight-cti", "arm,primecell";
		reg = <0x0 0x10cc5000 0x0 0x1000>;

		arm,primecell-periphid = <0x000bb922>;
		device-name = "cti_tmess_dragonlink1";

		qcom,extended_cti;
		clocks = <&aoss_qmp>;
		clock-names = "apb_pclk";
	};

	cti@10cc4000 {
		compatible = "arm,coresight-cti", "arm,primecell";
		reg = <0x0 0x10cc4000 0x0 0x1000>;

		arm,primecell-periphid = <0x000bb922>;
		device-name = "cti_tmess_dragonlink0";

		qcom,extended_cti;
		clocks = <&aoss_qmp>;
		clock-names = "apb_pclk";
	};

	cti@10010000 {
		compatible = "arm,coresight-cti", "arm,primecell";
		reg = <0x0 0x10010000 0x0 0x1000>;

		arm,primecell-periphid = <0x000bb922>;
		device-name = "cti_qdss";

		qcom,extended_cti;
		clocks = <&aoss_qmp>;
		clock-names = "apb_pclk";
	};

	cti@10845000 {
		compatible = "arm,coresight-cti", "arm,primecell";
		reg = <0x0 0x10845000 0x0 0x1000>;

		arm,primecell-periphid = <0x000bb922>;
		device-name = "cti_lpass_apb";

		qcom,extended_cti;
		clocks = <&aoss_qmp>;
		clock-names = "apb_pclk";
	};

	cti@10901000 {
		compatible = "arm,coresight-cti", "arm,primecell";
		reg = <0x0 0x10901000 0x0 0x1000>;

		arm,primecell-periphid = <0x000bb922>;
		device-name = "cti_dragonlink";

		status = "disabled";
		qcom,extended_cti;
		clocks = <&aoss_qmp>;
		clock-names = "apb_pclk";
	};

	cti@109b2000 {
		compatible = "arm,coresight-cti", "arm,primecell";
		reg = <0x0 0x109b2000 0x0 0x1000>;

		arm,primecell-periphid = <0x000bb922>;
		device-name = "cti_dlct2";

		qcom,extended_cti;
		clocks = <&aoss_qmp>;
		clock-names = "apb_pclk";
	};

	cti@10c2b000 {
		compatible = "arm,coresight-cti", "arm,primecell";
		reg = <0x0 0x10c2b000 0x0 0x1000>;

		arm,primecell-periphid = <0x000bb922>;
		device-name = "cti_dlct1";

		qcom,extended_cti;
		clocks = <&aoss_qmp>;
		clock-names = "apb_pclk";
	};

	cti@10c2a000 {
		compatible = "arm,coresight-cti", "arm,primecell";
		reg = <0x0 0x10c2a000 0x0 0x1000>;

		arm,primecell-periphid = <0x000bb922>;
		device-name = "cti_dlct0";

		qcom,extended_cti;
		clocks = <&aoss_qmp>;
		clock-names = "apb_pclk";
	};

	cti@10d21000 {
		compatible = "arm,coresight-cti", "arm,primecell";
		reg = <0x0 0x10d21000 0x0 0x1000>;

		arm,primecell-periphid = <0x000bb922>;
		device-name = "cti_ddr_ch_dl1";

		qcom,extended_cti;
		clocks = <&aoss_qmp>;
		clock-names = "apb_pclk";
	};

	cti@10d08000 {
		compatible = "arm,coresight-cti", "arm,primecell";
		reg = <0x0 0x10d08000 0x0 0x1000>;

		arm,primecell-periphid = <0x000bb922>;
		device-name = "cti_ddr_dl1";

		qcom,extended_cti;
		clocks = <&aoss_qmp>;
		clock-names = "apb_pclk";
	};

	cti@10d02000 {
		compatible = "arm,coresight-cti", "arm,primecell";
		reg = <0x0 0x10d02000 0x0 0x1000>;

		arm,primecell-periphid = <0x000bb922>;
		device-name = "cti_ddr_dl0";

		qcom,extended_cti;
		clocks = <&aoss_qmp>;
		clock-names = "apb_pclk";
	};

	cti@12862000 {
		compatible = "arm,coresight-cti", "arm,primecell";
		reg = <0x0 0x12862000 0x0 0x1000>;

		arm,primecell-periphid = <0x000bb922>;
		device-name = "cti_apss_dlct0";

		qcom,extended_cti;
		clocks = <&aoss_qmp>;
		clock-names = "apb_pclk";
	};

	cti@10b00000 {
		compatible = "arm,coresight-cti", "arm,primecell";
		reg = <0x0 0x10b00000 0x0 0x1000>;

		arm,primecell-periphid = <0x000bb922>;
		device-name = "cti_swao";

		qcom,extended_cti;
		clocks = <&aoss_qmp>;
		clock-names = "apb_pclk";
	};

	cti@10cd1000 {
		compatible = "arm,coresight-cti", "arm,primecell";
		reg = <0x0 0x10cd1000 0x0 0x1000>;

		arm,primecell-periphid = <0x000bb922>;
		device-name = "cti_tmess_rvss";
		status = "disabled";

		qcom,extended_cti;
		clocks = <&aoss_qmp>;
		clock-names = "apb_pclk";
	};

	cti@10ce1000 {
		compatible = "arm,coresight-cti", "arm,primecell";
		reg = <0x0 0x10ce1000 0x0 0x1000>;

		arm,primecell-periphid = <0x000bb922>;
		device-name = "cti_tmess_rvss_seqr";

		qcom,extended_cti;
		clocks = <&aoss_qmp>;
		clock-names = "apb_pclk";
	};

	cti@10b41000 {
		compatible = "arm,coresight-cti", "arm,primecell";
		reg = <0x0 0x10b41000 0x0 0x1000>;

		arm,primecell-periphid = <0x000bb922>;
		device-name = "cti_lpass1";

		status = "disabled";
		qcom,extended_cti;
		clocks = <&aoss_qmp>;
		clock-names = "apb_pclk";
	};

	cti@10d11000 {
		compatible = "arm,coresight-cti", "arm,primecell";
		reg = <0x0 0x10d11000 0x0 0x1000>;

		arm,primecell-periphid = <0x000bb922>;
		device-name = "cti_ddr";
		status = "disabled";

		qcom,extended_cti;
		clocks = <&aoss_qmp>;
		clock-names = "apb_pclk";
	};

	cti@10b21000 {
		compatible = "arm,coresight-cti", "arm,primecell";
		reg = <0x0 0x10b21000 0x0 0x1000>;

		arm,primecell-periphid = <0x000bb922>;
		device-name = "cti_aoss";

		status = "disabled";
		qcom,extended_cti;
		clocks = <&aoss_qmp>;
		clock-names = "apb_pclk";
	};

	cti@109ab000 {
		compatible = "arm,coresight-cti", "arm,primecell";
		reg = <0x0 0x109ab000 0x0 0x1000>;

		arm,primecell-periphid = <0x000bb922>;
		device-name = "cti_wpss";

		qcom,extended_cti;
		clocks = <&aoss_qmp>;
		clock-names = "apb_pclk";
	};

	cti@10b4b000 {
		compatible = "arm,coresight-cti", "arm,primecell";
		reg = <0x0 0x10b4b000 0x0 0x1000>;

		arm,primecell-periphid = <0x000bb922>;
		device-name = "cti_lpass0";

		status = "disabled";
		qcom,extended_cti;
		clocks = <&aoss_qmp>;
		clock-names = "apb_pclk";
	};

	cti@10962000 {
		compatible = "arm,coresight-cti", "arm,primecell";
		reg = <0x0 0x10962000 0x0 0x1000>;

		arm,primecell-periphid = <0x000bb922>;
		device-name = "cti_gpmu";

		status = "disabled";
		qcom,extended_cti;
		clocks = <&aoss_qmp>;
		clock-names = "apb_pclk";
	};

	cti@10961000 {
		compatible = "arm,coresight-cti", "arm,primecell";
		reg = <0x0 0x10961000 0x0 0x1000>;

		arm,primecell-periphid = <0x000bb922>;
		device-name = "cti_isdb";

		status = "disabled";
		qcom,extended_cti;
		clocks = <&aoss_qmp>;
		clock-names = "apb_pclk";
	};

	cti@12900000 {
		compatible = "arm,coresight-cti", "arm,primecell";
		reg = <0x0 0x12900000 0x0 0x1000>;

		arm,primecell-periphid = <0x000bb922>;
		device-name = "cti_apss2";

		qcom,extended_cti;
		clocks = <&aoss_qmp>;
		clock-names = "apb_pclk";
	};

	cti@128f0000 {
		compatible = "arm,coresight-cti", "arm,primecell";
		reg = <0x0 0x128f0000 0x0 0x1000>;

		arm,primecell-periphid = <0x000bb922>;
		device-name = "cti_apss1";

		qcom,extended_cti;
		clocks = <&aoss_qmp>;
		clock-names = "apb_pclk";
	};

	cti@128e0000 {
		compatible = "arm,coresight-cti", "arm,primecell";
		reg = <0x0 0x128e0000 0x0 0x1000>;

		arm,primecell-periphid = <0x000bb922>;
		device-name = "cti_apss0";

		qcom,extended_cti;
		clocks = <&aoss_qmp>;
		clock-names = "apb_pclk";
	};

	ipcb_tgu: tgu@10b0e000 {
		compatible = "arm,primecell";
		arm,primecell-periphid = <0x000bb999>;
		reg = <0x0 0x10b0e000 0x0 0x1000>;
		reg-names = "tgu-base";
		tgu-steps = <3>;
		tgu-conditions = <4>;
		tgu-regs = <5>;

		device-name = "tgu_ipcb";

		clocks = <&aoss_qmp>;
		clock-names = "apb_pclk";
	};

	spmi_tgu0: tgu@10b0f000 {
		compatible = "arm,primecell";
		arm,primecell-periphid = <0x000bb999>;

		reg = <0x0 0x10b0f000 0x0 0x1000>;
		reg-names = "tgu-base";

		tgu-steps = <3>;
		tgu-conditions = <4>;
		tgu-regs = <8>;

		device-name = "tgu_spmi0";

		clocks = <&aoss_qmp>;
		clock-names = "apb_pclk";
	};

	spmi_tgu1: tgu@10b10000 {
		compatible = "arm,primecell";
		arm,primecell-periphid = <0x000bb999>;

		reg = <0x0 0x10b10000 0x0 0x1000>;
		reg-names = "tgu-base";

		tgu-steps = <3>;
		tgu-conditions = <4>;
		tgu-regs = <8>;

		device-name = "tgu_spmi1";

		clocks = <&aoss_qmp>;
		clock-names = "apb_pclk";
	};

	csr: csr@10001000 {
		compatible = "qcom,coresight-csr";
		reg = <0x0 0x10001000 0x0 0x1000>;
		reg-names = "csr-base";

		device-name = "csr";

		qcom,hwctrl-set-support;
		qcom,set-byte-cntr-support;
		qcom,blk-size = <1>;
	};

	swao_csr: csr@10b11000 {
		compatible = "qcom,coresight-csr";
		reg = <0x0 0x10b11000 0x0 0x1000>,
			  <0x0 0x10b110f8 0x0 0x70>;
		reg-names = "csr-base", "msr-base";

		device-name = "swao_csr";

		qcom,timestamp-support;
		qcom,msr-support;
		qcom,blk-size = <1>;

		clocks = <&aoss_qmp>;
		clock-names = "apb_pclk";
	};

	ddr_tpdm_channel_0_1: tpdm@10d20000 {
		compatible = "qcom,coresight-tpdm", "arm,primecell";
		reg = <0x0 0x10d20000 0x0 0x1000>;
		reg-names = "tpdm-base";
		qcom,dsb-element-bits = <32>;
		qcom,dsb-msrs-num = <16>;

		device-name = "tpdm_ddr_01";
		status = "disabled";

		clocks = <&aoss_qmp>;
		clock-names = "apb_pclk";

		out-ports {
			port {
				ddr_tpdm_channel_0_1_out_ddr_ch_0_1_dl_0: endpoint {
					remote-endpoint =
						<&ddr_ch_0_1_dl_0_in_ddr_tpdm_channel_0_1>;
				};
			};
		};
	};

	ddr_ch_0_1_dl: funnel@10d22000 {
		compatible = "arm,coresight-dynamic-funnel", "arm,primecell";
		reg = <0x0 0x10d22000 0x0 0x1000>;
		reg-names = "funnel-base";

		device-name = "funnel_ddr_ch01";

		clocks = <&aoss_qmp>;
		clock-names = "apb_pclk";

		in-ports {
			port@0 {
				ddr_ch_0_1_dl_0_in_ddr_tpdm_channel_0_1: endpoint {
					remote-endpoint =
						<&ddr_tpdm_channel_0_1_out_ddr_ch_0_1_dl_0>;
				};
			};
		};

		out-ports {
			port {
				ddr_ch_0_1_dl_out_dl_0_ddr_0: endpoint {
					remote-endpoint =
						<&dl_0_ddr_0_in_ddr_ch_0_1_dl>;
				};
			};
		};
	};

	ddr_tpdm_ddr_dl_0_dsb_cmb: tpdm@10d00000 {
		compatible = "qcom,coresight-tpdm", "arm,primecell";
		reg = <0x0 0x10d00000 0x0 0x1000>;
		reg-names = "tpdm-base";
		qcom,dsb-element-bits = <32>;
		qcom,dsb-msrs-num = <32>;
		qcom,cmb-element-bits = <32>;
		qcom,cmb-msrs-num = <1>;

		device-name = "tpdm_ddr_dl0";
		status = "disabled";

		clocks = <&aoss_qmp>;
		clock-names = "apb_pclk";

		out-ports {
			port {
				ddr_tpdm_ddr_dl_0_dsb_cmb_out_dl_0_ddr_2: endpoint {
					remote-endpoint =
						<&dl_0_ddr_2_in_ddr_tpdm_ddr_dl_0_dsb_cmb>;
				};
			};
		};
	};

	ddr_tpdm_ddr_dpm: tpdm@10d01000 {
		compatible = "qcom,coresight-tpdm", "arm,primecell";
		reg = <0x0 0x10d01000 0x0 0x1000>;
		reg-names = "tpdm-base";
		qcom,cmb-element-bits = <64>;
		qcom,cmb-msrs-num = <1>;

		device-name = "tpdm_ddr_dpm";
		status = "disabled";

		clocks = <&aoss_qmp>;
		clock-names = "apb_pclk";

		out-ports {
			port {
				ddr_tpdm_ddr_dpm_out_dl_0_ddr_3: endpoint {
					remote-endpoint =
						<&dl_0_ddr_3_in_ddr_tpdm_ddr_dpm>;
				};
			};
		};
	};

	gladiator: gladiator {
		compatible = "arm,coresight-dummy-source";
		device-name = "gladiator";
		atid = <96>;

		out-ports {
			port {
				gladiator_out_dl_1_ddr: endpoint {
					remote-endpoint =
					<&dl_1_ddr_in_gladiator>;
				};
			};
		};
	};

	dl_1_ddr: funnel@10d0a000 {
		compatible = "arm,coresight-dynamic-funnel", "arm,primecell";
		reg = <0x0 0x10d0a000 0x0 0x1000>;
		reg-names = "funnel-base";

		device-name = "funnel_ddr_dl1";

		clocks = <&aoss_qmp>;
		clock-names = "apb_pclk";

		in-ports {
			port@3 {
				reg = <3>;
				dl_1_ddr_in_gladiator: endpoint {
					remote-endpoint =
					<&gladiator_out_dl_1_ddr>;
				};
			};
		};

		out-ports {
			port {
				dl_1_ddr_out_dl_0_ddr_4: endpoint {
					remote-endpoint =
						<&dl_0_ddr_4_in_dl_1_ddr>;
				};
			};
		};
	};

	dl_0_ddr: funnel@10d03000 {
		compatible = "arm,coresight-dynamic-funnel", "arm,primecell";
		reg = <0x0 0x10d03000 0x0 0x1000>;
		reg-names = "funnel-base";

		device-name = "funnel_ddr_dl";

		clocks = <&aoss_qmp>;
		clock-names = "apb_pclk";

		in-ports {
			#address-cells = <1>;
			#size-cells = <0>;
			port@0 {
				reg = <0>;
				dl_0_ddr_0_in_ddr_ch_0_1_dl: endpoint {
					remote-endpoint =
						<&ddr_ch_0_1_dl_out_dl_0_ddr_0>;
				};
			};

			port@2 {
				reg = <2>;
				dl_0_ddr_2_in_ddr_tpdm_ddr_dl_0_dsb_cmb: endpoint {
					remote-endpoint =
						<&ddr_tpdm_ddr_dl_0_dsb_cmb_out_dl_0_ddr_2>;
				};
			};

			port@3 {
				reg = <3>;
				dl_0_ddr_3_in_ddr_tpdm_ddr_dpm: endpoint {
					remote-endpoint =
						<&ddr_tpdm_ddr_dpm_out_dl_0_ddr_3>;
				};
			};

			port@4 {
				reg = <4>;
				dl_0_ddr_4_in_dl_1_ddr: endpoint {
					remote-endpoint =
						<&dl_1_ddr_out_dl_0_ddr_4>;
				};
			};
		};

		out-ports {
			#address-cells = <1>;
			#size-cells = <0>;
			port@0 {
				reg = <0>;
				dl_0_ddr_out_dl_center0_2: endpoint {
					remote-endpoint =
						<&dl_center0_2_in_dl_0_ddr>;
				filter-source = <&gladiator>;
				};
			};

			port@1 {
				reg = <1>;
				dl_0_ddr_out_tpda_dlct0_4: endpoint {
					remote-endpoint =
						<&tpda_dlct0_4_in_dl_0_ddr>;
				filter-source = <&ddr_tpdm_channel_0_1>;
				};
			};

			port@2 {
				reg = <2>;
				dl_0_ddr_out_tpda_dlct0_6: endpoint {
					remote-endpoint =
						<&tpda_dlct0_6_in_dl_0_ddr>;
				filter-source = <&ddr_tpdm_ddr_dl_0_dsb_cmb>;
				};
			};

			port@3 {
				reg = <3>;
				dl_0_ddr_out_tpda_dlct0_7: endpoint {
					remote-endpoint =
						<&tpda_dlct0_7_in_dl_0_ddr>;
				filter-source = <&ddr_tpdm_ddr_dpm>;
				};
			};
		};
	};

	gfx_tpdm_gfx: tpdm@10900000 {
		compatible = "qcom,coresight-tpdm", "arm,primecell";
		reg = <0x0 0x10900000 0x0 0x1000>;
		reg-names = "tpdm-base";
		qcom,dsb-element-bits = <32>;
		qcom,dsb-msrs-num = <8>;

		device-name = "tpdm_gfx";
		status = "disabled";

		clocks = <&aoss_qmp>;
		clock-names = "apb_pclk";

		out-ports {
			port {
				gfx_tpdm_gfx_out_gfx_dl_0: endpoint {
					remote-endpoint =
						<&gfx_dl_0_in_gfx_tpdm_gfx>;
				};
			};
		};
	};

	gfx_dl: funnel@10902000 {
		compatible = "arm,coresight-dynamic-funnel", "arm,primecell";
		reg = <0x0 0x10902000 0x0 0x1000>;
		reg-names = "funnel-base";

		device-name = "funnel_gfx_dl";

		clocks = <&aoss_qmp>;
		clock-names = "apb_pclk";

		in-ports {
			port@0 {
				gfx_dl_0_in_gfx_tpdm_gfx: endpoint {
					remote-endpoint =
						<&gfx_tpdm_gfx_out_gfx_dl_0>;
				};
			};
		};

		out-ports {
			port {
				gfx_dl_out_tpda_dlct0_19: endpoint {
					remote-endpoint =
						<&tpda_dlct0_19_in_gfx_dl>;
				};
			};
		};
	};

	qm_tpdm_qm: tpdm@109d0000 {
		compatible = "qcom,coresight-tpdm", "arm,primecell";
		reg = <0x0 0x109d0000 0x0 0x1000>;
		reg-names = "tpdm-base";
		qcom,dsb-element-bits = <32>;

		device-name = "tpdm_qm";
		status = "disabled";

		clocks = <&aoss_qmp>;
		clock-names = "apb_pclk";

		out-ports {
			port {
				qm_tpdm_qm_out_tpda_dlct0_22: endpoint {
					remote-endpoint =
						<&tpda_dlct0_22_in_qm_tpdm_qm>;
				};
			};
		};
	};

	gcc_tpdm_gcc_dsb: tpdm@1082c000 {
		compatible = "qcom,coresight-tpdm", "arm,primecell";
		reg = <0x0 0x1082c000 0x0 0x1000>;
		reg-names = "tpdm-base";
		qcom,dsb-element-bits = <32>;
		qcom,dsb-msrs-num = <16>;

		device-name = "tpdm_gcc";
		status = "disabled";

		clocks = <&aoss_qmp>;
		clock-names = "apb_pclk";

		out-ports {
			port {
				gcc_tpdm_gcc_dsb_out_tpda_dlct0_23: endpoint {
					remote-endpoint =
						<&tpda_dlct0_23_in_gcc_tpdm_gcc_dsb>;
				};
			};
		};
	};

	vsense_tpdm_vsense: tpdm@10840000 {
		compatible = "qcom,coresight-tpdm", "arm,primecell";
		reg = <0x0 0x10840000 0x0 0x1000>;
		reg-names = "tpdm-base";
		qcom,cmb-element-bits = <32>;

		device-name = "tpdm_vsense";
		status = "disabled";

		clocks = <&aoss_qmp>;
		clock-names = "apb_pclk";

		out-ports {
			port {
				vsense_tpdm_vsense_out_tpda_dlct0_24: endpoint {
					remote-endpoint =
						<&tpda_dlct0_24_in_vsense_tpdm_vsense>;
				};
			};
		};
	};

	ipa_tpdm_ipa: tpdm@10c22000 {
		compatible = "qcom,coresight-tpdm", "arm,primecell";
		reg = <0x0 0x10c22000 0x0 0x1000>;
		reg-names = "tpdm-base";
		qcom,cmb-element-bits = <64>;
		qcom,cmb-msrs-num = <1>;

		device-name = "tpdm_ipa";
		status = "disabled";

		clocks = <&aoss_qmp>;
		clock-names = "apb_pclk";

		out-ports {
			port {
				ipa_tpdm_ipa_out_tpda_dlct0_26: endpoint {
					remote-endpoint =
						<&tpda_dlct0_26_in_ipa_tpdm_ipa>;
				};
			};
		};
	};

	pimem_tpdm_pimem: tpdm@10842000 {
		compatible = "qcom,coresight-tpdm", "arm,primecell";
		reg = <0x0 0x10842000 0x0 0x1000>;
		reg-names = "tpdm-base";
		qcom,cmb-element-bits = <64>;
		qcom,dsb-element-bits = <32>;

		device-name = "tpdm_pimem";
		status = "disabled";

		clocks = <&aoss_qmp>;
		clock-names = "apb_pclk";
		out-ports {
			port {
				pimem_tpdm_pimem_out_tpda_dlct0_28: endpoint {
					remote-endpoint =
						<&tpda_dlct0_28_in_pimem_tpdm_pimem>;
				};
			};
		};
	};

	sdcc5_tpdm_sdcc5_wrapper_1: tpdm@10c21000 {
		compatible = "qcom,coresight-tpdm", "arm,primecell";
		reg = <0x0 0x10c21000 0x0 0x1000>;
		reg-names = "tpdm-base";
		qcom,cmb-element-bits = <32>;

		device-name = "tpdm_sdcc1";
		status = "disabled";

		clocks = <&aoss_qmp>;
		clock-names = "apb_pclk";
		out-ports {
			port {
				sdcc5_tpdm_sdcc5_wrapper_1_out_tpda_dlwt_1: endpoint {
					remote-endpoint =
						<&tpda_dlwt_1_in_sdcc5_tpdm_sdcc5_wrapper_1>;
				};
			};
		};
	};

	sdcc5_tpdm_sdcc5_wrapper_2: tpdm@10c20000 {
		compatible = "qcom,coresight-tpdm", "arm,primecell";
		reg = <0x0 0x10c20000 0x0 0x1000>;
		reg-names = "tpdm-base";
		qcom,cmb-element-bits = <32>;

		device-name = "tpdm_sdcc2";
		status = "disabled";

		clocks = <&aoss_qmp>;
		clock-names = "apb_pclk";
		out-ports {
			port {
				sdcc5_tpdm_sdcc5_wrapper_2_out_tpda_dlwt_2: endpoint {
					remote-endpoint =
						<&tpda_dlwt_2_in_sdcc5_tpdm_sdcc5_wrapper_2>;
				};
			};
		};
	};

	dl_center1: funnel@10c0b000 {
		compatible = "arm,coresight-dynamic-funnel", "arm,primecell";
		reg = <0x0 0x10c0b000 0x0 0x1000>;
		reg-names = "funnel-base";

		device-name = "funnel_dlct1";

		clocks = <&aoss_qmp>;
		clock-names = "apb_pclk";
		in-ports {
			port@0 {
				dl_center1_0_in_tpda_dlct1: endpoint {
					remote-endpoint =
						<&tpda_dlct1_out_dl_center1_0>;
				};
			};
		};

		out-ports {
			port {
				dl_center1_out_fun_in1_qdss_6: endpoint {
					remote-endpoint =
						<&fun_in1_qdss_6_in_dl_center1>;
				};
			};
		};
	};

	tpda_dlct1: tpda@10c0a000 {
		compatible = "qcom,coresight-tpda", "arm,primecell";
		reg = <0x0 0x10c0a000 0x0 0x1000>;
		reg-names = "tpda-base";

		device-name = "tpda_dlct1";

		clocks = <&aoss_qmp>;
		clock-names = "apb_pclk";
		in-ports {
			#address-cells = <1>;
			#size-cells = <0>;
			port@2 {
				reg = <2>;
				tpda_dlct1_2_in_dl_center_1_tpdm_qrng_cmb: endpoint {
					remote-endpoint =
						<&dl_center_1_tpdm_qrng_cmb_out_tpda_dlct1_2>;
				};
			};

			port@3 {
				reg = <3>;
				tpda_dlct1_3_in_dl_center_1_tpdm_pmu_cmb: endpoint {
					remote-endpoint =
						<&dl_center_1_tpdm_pmu_cmb_out_tpda_dlct1_3>;
				};
			};
		};

		out-ports {
			port {
				tpda_dlct1_out_dl_center1_0: endpoint {
					remote-endpoint =
						<&dl_center1_0_in_tpda_dlct1>;
				};
			};
		};
	};

	dl_center_1_tpdm_qrng_cmb: tpdm@10c08000 {
		compatible = "qcom,coresight-tpdm", "arm,primecell";
		reg = <0x0 0x10c08000 0x0 0x1000>;
		reg-names = "tpdm-base";
		qcom,cmb-element-bits = <32>;

		device-name = "tpdm_qrng_cmb";
		status = "disabled";

		clocks = <&aoss_qmp>;
		clock-names = "apb_pclk";
		out-ports {
			port {
				dl_center_1_tpdm_qrng_cmb_out_tpda_dlct1_2: endpoint {
					remote-endpoint =
						<&tpda_dlct1_2_in_dl_center_1_tpdm_qrng_cmb>;
				};
			};
		};
	};

	dl_center_1_tpdm_pmu_cmb: tpdm@10c09000 {
		compatible = "qcom,coresight-tpdm", "arm,primecell";
		reg = <0x0 0x10c09000 0x0 0x1000>;
		reg-names = "tpdm-base";
		qcom,cmb-element-bits = <64>;
		qcom,cmb-msrs-num = <1>;

		device-name = "tpdm_pmu_cmb";
		status = "disabled";

		clocks = <&aoss_qmp>;
		clock-names = "apb_pclk";
		out-ports {
			port {
				dl_center_1_tpdm_pmu_cmb_out_tpda_dlct1_3: endpoint {
					remote-endpoint =
						<&tpda_dlct1_3_in_dl_center_1_tpdm_pmu_cmb>;
				};
			};
		};
	};

	tme: funnel@10cc7000 {
		compatible = "arm,coresight-dynamic-funnel", "arm,primecell";
		reg = <0x0 0x10cc7000 0x0 0x1000>;
		reg-names = "funnel-base";

		device-name = "funnel_tme";

		clocks = <&aoss_qmp>;
		clock-names = "apb_pclk";

		in-ports {
			port@0 {
				tme_0_in_tpda_tme: endpoint {
					remote-endpoint =
						<&tpda_tme_out_tme_0>;
				};
			};
		};

		out-ports {
			port {
				tme_out_fun_in1_qdss_1: endpoint {
					remote-endpoint =
						<&fun_in1_qdss_1_in_tme>;
				};
			};
		};
	};

	tpda_tme: tpda@10cc6000 {
		compatible = "qcom,coresight-tpda", "arm,primecell";
		reg = <0x0 0x10cc6000 0x0 0x1000>;
		reg-names = "tpda-base";

		device-name = "tpda_tme";

		clocks = <&aoss_qmp>;
		clock-names = "apb_pclk";

		in-ports {
			#address-cells = <1>;
			#size-cells = <0>;
			port@1 {
				reg = <1>;
				tpda_tme_1_in_tmess_tpdm_e21_cpu_cmb: endpoint {
					remote-endpoint =
						<&tmess_tpdm_e21_cpu_cmb_out_tpda_tme_1>;
				};
			};

			port@2 {
				reg = <2>;
				tpda_tme_2_in_tmess_tpdm_seq_cpu_cmb: endpoint {
					remote-endpoint =
						<&tmess_tpdm_seq_cpu_cmb_out_tpda_tme_2>;
				};
			};

			port@3 {
				reg = <3>;
				tpda_tme_3_in_tmess_tpdm_qrng_cmb: endpoint {
					remote-endpoint =
						<&tmess_tpdm_qrng_cmb_out_tpda_tme_3>;
				};
			};

			port@4 {
				reg = <4>;
				tpda_tme_4_in_tmess_tpdm_dl_cmb_dsb: endpoint {
					remote-endpoint =
						<&tmess_tpdm_dl_cmb_dsb_out_tpda_tme_4>;
				};
			};
		};

		out-ports {
			port {
				tpda_tme_out_tme_0: endpoint {
					remote-endpoint =
						<&tme_0_in_tpda_tme>;
				};
			};
		};
	};

	tmess_tpdm_e21_cpu_cmb: tpdm@10cc0000 {
		compatible = "qcom,coresight-tpdm", "arm,primecell";
		reg = <0x0 0x10cc0000 0x0 0x1000>;
		reg-names = "tpdm-base";
		qcom,cmb-element-bits = <32>;
		qcom,cmb-msrs-num = <12>;

		device-name = "tpdm_tmess_e21";
		status = "disabled";

		clocks = <&aoss_qmp>;
		clock-names = "apb_pclk";
		out-ports {
			port {
				tmess_tpdm_e21_cpu_cmb_out_tpda_tme_1: endpoint {
					remote-endpoint =
						<&tpda_tme_1_in_tmess_tpdm_e21_cpu_cmb>;
				};
			};
		};
	};

	tmess_tpdm_seq_cpu_cmb: tpdm@10cc1000 {
		compatible = "qcom,coresight-tpdm", "arm,primecell";
		reg = <0x0 0x10cc1000 0x0 0x1000>;
		reg-names = "tpdm-base";
		qcom,cmb-element-bits = <32>;
		qcom,cmb-msrs-num = <12>;

		device-name = "tpdm_tmess_seq";
		status = "disabled";

		clocks = <&aoss_qmp>;
		clock-names = "apb_pclk";
		out-ports {
			port {
				tmess_tpdm_seq_cpu_cmb_out_tpda_tme_2: endpoint {
					remote-endpoint =
						<&tpda_tme_2_in_tmess_tpdm_seq_cpu_cmb>;
				};
			};
		};
	};

	tmess_tpdm_qrng_cmb: tpdm@10cc2000 {
		compatible = "qcom,coresight-tpdm", "arm,primecell";
		reg = <0x0 0x10cc2000 0x0 0x1000>;
		reg-names = "tpdm-base";
		qcom,cmb-element-bits = <32>;

		device-name = "tpdm_tmess_qrng";
		status = "disabled";

		clocks = <&aoss_qmp>;
		clock-names = "apb_pclk";
		out-ports {
			port {
				tmess_tpdm_qrng_cmb_out_tpda_tme_3: endpoint {
					remote-endpoint =
						<&tpda_tme_3_in_tmess_tpdm_qrng_cmb>;
				};
			};
		};
	};

	tmess_tpdm_dl_cmb_dsb: tpdm@10cc3000 {
		compatible = "qcom,coresight-tpdm", "arm,primecell";
		reg = <0x0 0x10cc3000 0x0 0x1000>;
		reg-names = "tpdm-base";
		qcom,cmb-element-bits = <64>;
		qcom,dsb-element-bits = <64>;
		qcom,dsb-msrs-num = <32>;
		qcom,cmb-msrs-num = <1>;

		device-name = "tpdm_tmess_cmb_dsb";
		status = "disabled";

		clocks = <&aoss_qmp>;
		clock-names = "apb_pclk";
		out-ports {
			port {
				tmess_tpdm_dl_cmb_dsb_out_tpda_tme_4: endpoint {
					remote-endpoint =
						<&tpda_tme_4_in_tmess_tpdm_dl_cmb_dsb>;
				};
			};
		};
	};

	tpda_dlct0: tpda@10c2c000 {
		compatible = "qcom,coresight-tpda", "arm,primecell";
		reg = <0x0 0x10c2c000 0x0 0x1000>;
		reg-names = "tpda-base";

		device-name = "tpda_dlct0";

		clocks = <&aoss_qmp>;
		clock-names = "apb_pclk";
		in-ports {
			#address-cells = <1>;
			#size-cells = <0>;
			port@0 {
				reg = <0>;
				tpda_dlct0_0_in_lpass_cx_dl: endpoint {
					remote-endpoint =
						<&lpass_cx_dl_out_tpda_dlct0_0>;
				};
			};

			port@4 {
				reg = <4>;
				tpda_dlct0_4_in_dl_0_ddr: endpoint {
					remote-endpoint =
						<&dl_0_ddr_out_tpda_dlct0_4>;
				};
			};

			port@6 {
				reg = <6>;
				tpda_dlct0_6_in_dl_0_ddr: endpoint {
					remote-endpoint =
						<&dl_0_ddr_out_tpda_dlct0_6>;
				};
			};

			port@7 {
				reg = <7>;
				tpda_dlct0_7_in_dl_0_ddr: endpoint {
					remote-endpoint =
						<&dl_0_ddr_out_tpda_dlct0_7>;
				};
			};

			port@13 {
				reg = <19>;
				tpda_dlct0_19_in_gfx_dl: endpoint {
					remote-endpoint =
						<&gfx_dl_out_tpda_dlct0_19>;
				};
			};

			port@16 {
				reg = <22>;
				tpda_dlct0_22_in_qm_tpdm_qm: endpoint {
					remote-endpoint =
						<&qm_tpdm_qm_out_tpda_dlct0_22>;
				};
			};

			port@17 {
				reg = <23>;
				tpda_dlct0_23_in_gcc_tpdm_gcc_dsb: endpoint {
					remote-endpoint =
						<&gcc_tpdm_gcc_dsb_out_tpda_dlct0_23>;
				};
			};

			port@18 {
				reg = <24>;
				tpda_dlct0_24_in_vsense_tpdm_vsense: endpoint {
					remote-endpoint =
						<&vsense_tpdm_vsense_out_tpda_dlct0_24>;
				};
			};

			port@1a {
				reg = <26>;
				tpda_dlct0_26_in_ipa_tpdm_ipa: endpoint {
					remote-endpoint =
						<&ipa_tpdm_ipa_out_tpda_dlct0_26>;
				};
			};

			port@1c {
				reg = <28>;
				tpda_dlct0_28_in_pimem_tpdm_pimem: endpoint {
					remote-endpoint =
						<&pimem_tpdm_pimem_out_tpda_dlct0_28>;
				};
			};

			port@1d {
				reg = <29>;
				tpda_dlct0_29_in_dl_center_0_tpdm_dl_center_dsb: endpoint {
					remote-endpoint =
						<&dl_center_0_tpdm_dl_center_dsb_out_tpda_dlct0_29>;
				};
			};

			port@1e {
				reg = <30>;
				tpda_dlct0_30_in_dl_center_0_tpdm_ipcc_cmb: endpoint {
					remote-endpoint =
						<&dl_center_0_tpdm_ipcc_cmb_out_tpda_dlct0_30>;
				};
			};
		};

		out-ports {
			port {
				tpda_dlct0_out_dl_center0_0: endpoint {
					remote-endpoint =
						<&dl_center0_0_in_tpda_dlct0>;
				};
			};
		};
	};

	dl_center0: funnel@10c2d000 {
		compatible = "arm,coresight-dynamic-funnel", "arm,primecell";
		reg = <0x0 0x10c2d000 0x0 0x1000>;
		reg-names = "funnel-base";

		device-name = "funnel_dl_center0";

		clocks = <&aoss_qmp>;
		clock-names = "apb_pclk";
		in-ports {
			#address-cells = <1>;
			#size-cells = <0>;
			port@0 {
				reg = <0>;
				dl_center0_0_in_tpda_dlct0: endpoint {
					remote-endpoint =
						<&tpda_dlct0_out_dl_center0_0>;
				};
			};

			port@2 {
				reg = <2>;
				dl_center0_2_in_dl_0_ddr: endpoint {
					remote-endpoint =
						<&dl_0_ddr_out_dl_center0_2>;
				};
			};

			port@7 {
				reg = <7>;
				dl_center0_7_in__modem_dl: endpoint {
					remote-endpoint =
						<&modem_dl_out_dl_center0_7>;
				};
			};
		};

		out-ports {
			port {
				dl_center0_out_fun_in1_qdss_5: endpoint {
					remote-endpoint =
						<&fun_in1_qdss_5_in_dl_center0>;
				};
			};
		};
	};

	dl_center_0_tpdm_dl_center_dsb: tpdm@10c28000 {
		compatible = "qcom,coresight-tpdm", "arm,primecell";
		reg = <0x0 0x10c28000 0x0 0x1000>;
		reg-names = "tpdm-base";
		qcom,dsb-element-bits = <32>;
		qcom,dsb-msrs-num = <32>;

		device-name = "tpdm_dlct_dsb";
		status = "disabled";

		clocks = <&aoss_qmp>;
		clock-names = "apb_pclk";
		out-ports {
			port {
				dl_center_0_tpdm_dl_center_dsb_out_tpda_dlct0_29: endpoint {
					remote-endpoint =
						<&tpda_dlct0_29_in_dl_center_0_tpdm_dl_center_dsb>;
				};
			};
		};
	};

	dl_center_0_tpdm_ipcc_cmb: tpdm@10c29000 {
		compatible = "qcom,coresight-tpdm", "arm,primecell";
		reg = <0x0 0x10c29000 0x0 0x1000>;
		reg-names = "tpdm-base";
		qcom,cmb-element-bits = <64>;
		qcom,cmb-msrs-num = <1>;

		device-name = "tpdm_ipcc_cmb";
		status = "disabled";

		clocks = <&aoss_qmp>;
		clock-names = "apb_pclk";
		out-ports {
			port {
				dl_center_0_tpdm_ipcc_cmb_out_tpda_dlct0_30: endpoint {
					remote-endpoint =
						<&tpda_dlct0_30_in_dl_center_0_tpdm_ipcc_cmb>;
				};
			};
		};
	};

	dl_center_2_tpdm_dl_center2_dsb: tpdm@109b0000 {
		compatible = "qcom,coresight-tpdm", "arm,primecell";
		reg = <0x0 0x109b0000 0x0 0x1000>;
		reg-names = "tpdm-base";
		qcom,dsb-element-bits = <32>;
		qcom,dsb-msrs-num = <32>;

		device-name = "tpdm_dlct2_dsb";
		status = "disabled";

		clocks = <&aoss_qmp>;
		clock-names = "apb_pclk";

		out-ports {
			port {
				dl_center_2_tpdm_dl_center2_dsb_out_tpda_dlct2_26: endpoint {
					remote-endpoint =
						<&tpda_dlct2_26_in_dl_center_2_tpdm_dl_center2_dsb>;
				};
			};
		};
	};

	dl_center_2_tpdm_dl_center2_cmb: tpdm@109b1000 {
		compatible = "qcom,coresight-tpdm", "arm,primecell";
		reg = <0x0 0x109b1000 0x0 0x1000>;
		reg-names = "tpdm-base";
		qcom,cmb-element-bits = <64>;
		qcom,cmb-msrs-num = <1>;

		device-name = "tpdm_dlct2_cmb";
		status = "disabled";

		clocks = <&aoss_qmp>;
		clock-names = "apb_pclk";
		out-ports {
			port {
				dl_center_2_tpdm_dl_center2_cmb_out_tpda_dlct2_27: endpoint {
					remote-endpoint =
						<&tpda_dlct2_27_in_dl_center_2_tpdm_dl_center2_cmb>;
				};
			};
		};
	};

	tpda_dlct2: tpda@109b3000 {
		compatible = "qcom,coresight-tpda", "arm,primecell";
		reg = <0x0 0x109b3000 0x0 0x1000>;
		reg-names = "tpda-base";

		device-name = "tpda_dlct2";

		clocks = <&aoss_qmp>;
		clock-names = "apb_pclk";
		in-ports {
			#address-cells = <1>;
			#size-cells = <0>;
			port@5 {
				reg = <5>;
				tpda_dlct2_5_in_wpss_funnel: endpoint {
					remote-endpoint =
						<&wpss_funnel_out_tpda_dlct2_5>;
				};
			};

			port@1a {
				reg = <26>;
				tpda_dlct2_26_in_dl_center_2_tpdm_dl_center2_dsb: endpoint {
					remote-endpoint =
						<&dl_center_2_tpdm_dl_center2_dsb_out_tpda_dlct2_26>;
				};
			};

			port@1b {
				reg = <27>;
				tpda_dlct2_27_in_dl_center_2_tpdm_dl_center2_cmb: endpoint {
					remote-endpoint =
						<&dl_center_2_tpdm_dl_center2_cmb_out_tpda_dlct2_27>;
				};
			};
		};

		out-ports {
			port {
				tpda_dlct2_out_dl_center2_0: endpoint {
					remote-endpoint =
						<&dl_center2_0_in_tpda_dlct2>;
				};
			};
		};
	};

	dl_center2: funnel@109b4000 {
		compatible = "arm,coresight-dynamic-funnel", "arm,primecell";
		reg = <0x0 0x109b4000 0x0 0x1000>;
		reg-names = "funnel-base";

		device-name = "funnel_dlct2";

		clocks = <&aoss_qmp>;
		clock-names = "apb_pclk";
		in-ports {
			#address-cells = <1>;
			#size-cells = <0>;
			port@0 {
				reg = <0>;
				dl_center2_0_in_tpda_dlct2: endpoint {
					remote-endpoint =
						<&tpda_dlct2_out_dl_center2_0>;
				};
			};

			port@4 {
				reg = <4>;
				dl_center2_4_in_wpss_funnel: endpoint {
					remote-endpoint =
						<&wpss_funnel_out_dl_center2_4>;
				};
			};
		};

		out-ports {
			port {
				dl_center2_out_fun_in1_qdss_4: endpoint {
					remote-endpoint =
						<&fun_in1_qdss_4_in_dl_center2>;
				};
			};
		};
	};

	dl_west_tpdm_dl_west_dsb: tpdm@10c38000 {
		compatible = "qcom,coresight-tpdm", "arm,primecell";
		reg = <0x0 0x10c38000 0x0 0x1000>;
		reg-names = "tpdm-base";
		qcom,dsb-element-bits = <32>;
		qcom,dsb-msrs-num = <16>;

		device-name = "tpdm_dlwest_dsb";
		status = "disabled";

		clocks = <&aoss_qmp>;
		clock-names = "apb_pclk";
		out-ports {
			port {
				dl_west_tpdm_dl_west_dsb_out_tpda_dlwt_3: endpoint {
					remote-endpoint =
						<&tpda_dlwt_3_in_dl_west_tpdm_dl_west_dsb>;
				};
			};
		};
	};

	tpda_dlwt: tpda@10c39000 {
		compatible = "qcom,coresight-tpda", "arm,primecell";
		reg = <0x0 0x10c39000 0x0 0x1000>;
		reg-names = "tpda-base";

		device-name = "tpda_dlwt";
		status = "disabled";

		clocks = <&aoss_qmp>;
		clock-names = "apb_pclk";
		in-ports {
			#address-cells = <1>;
			#size-cells = <0>;
			port@1 {
				reg = <1>;
				tpda_dlwt_1_in_sdcc5_tpdm_sdcc5_wrapper_1: endpoint {
					remote-endpoint =
						<&sdcc5_tpdm_sdcc5_wrapper_1_out_tpda_dlwt_1>;
				};
			};

			port@2 {
				reg = <2>;
				tpda_dlwt_2_in_sdcc5_tpdm_sdcc5_wrapper_2: endpoint {
					remote-endpoint =
						<&sdcc5_tpdm_sdcc5_wrapper_2_out_tpda_dlwt_2>;
				};
			};

			port@3 {
				reg = <3>;
				tpda_dlwt_3_in_dl_west_tpdm_dl_west_dsb: endpoint {
					remote-endpoint =
						<&dl_west_tpdm_dl_west_dsb_out_tpda_dlwt_3>;
				};
			};
		};

		out-ports {
			port {
				tpda_dlwt_out_dl_west_0: endpoint {
					remote-endpoint =
						<&dl_west_0_in_tpda_dlwt>;
				};
			};
		};
	};

	dl_west: funnel@10c3a000 {
		compatible = "arm,coresight-dynamic-funnel", "arm,primecell";
		reg = <0x0 0x10c3a000 0x0 0x1000>;
		reg-names = "funnel-base";

		device-name = "funnel_dlwest";
		status = "disabled";

		clocks = <&aoss_qmp>;
		clock-names = "apb_pclk";
		in-ports {
			port@0 {
				dl_west_0_in_tpda_dlwt: endpoint {
					remote-endpoint =
						<&tpda_dlwt_out_dl_west_0>;
				};
			};
		};

		out-ports {
			port {
				dl_west_out_fun_in1_qdss_0: endpoint {
					remote-endpoint =
						<&fun_in1_qdss_0_in_dl_west>;
				};
			};
		};
	};

	qdss_tpdm_dcc: tpdm@10003000 {
		compatible = "qcom,coresight-tpdm", "arm,primecell";
		reg = <0x0 0x10003000 0x0 0x1000>;
		reg-names = "tpda-base";
		qcom,cmb-element-bits = <32>;

		device-name = "tpdm_dcc";
		status = "disabled";

		clocks = <&aoss_qmp>;
		clock-names = "apb_pclk";
		out-ports {
			port {
				qdss_tpdm_dcc_out_tpda_qdss_0: endpoint {
					remote-endpoint =
						<&tpda_qdss_0_in_qdss_tpdm_dcc>;
				};
			};
		};
	};

	qdss_tpdm_spdm_cmb: tpdm@1000f000 {
		compatible = "qcom,coresight-tpdm", "arm,primecell";
		reg = <0x0 0x1000f000 0x0 0x1000>;
		reg-names = "tpda-base";
		qcom,cmb-element-bits = <32>;

		device-name = "tpdm_spdm_cmb";
		status = "disabled";

		clocks = <&aoss_qmp>;
		clock-names = "apb_pclk";
		out-ports {
			port {
				qdss_tpdm_spdm_cmb_out_tpda_qdss_1: endpoint {
					remote-endpoint =
						<&tpda_qdss_1_in_qdss_tpdm_spdm_cmb>;
				};
			};
		};
	};

	tpda_qdss: tpda@10004000 {
		compatible = "qcom,coresight-tpda", "arm,primecell";
		reg = <0x0 0x10004000 0x0 0x1000>;
		reg-names = "tpda-base";

		device-name = "tpda_qdss";

		clocks = <&aoss_qmp>;
		clock-names = "apb_pclk";

		in-ports {
			#address-cells = <1>;
			#size-cells = <0>;
			port@0 {
				reg = <0>;
				tpda_qdss_0_in_qdss_tpdm_dcc: endpoint {
					remote-endpoint =
						<&qdss_tpdm_dcc_out_tpda_qdss_0>;
				};
			};

			port@1 {
				reg = <1>;
				tpda_qdss_1_in_qdss_tpdm_spdm_cmb: endpoint {
					remote-endpoint =
						<&qdss_tpdm_spdm_cmb_out_tpda_qdss_1>;
				};
			};
		};

		out-ports {
			port {
				tpda_qdss_out_fun_in0_qdss_6: endpoint {
					remote-endpoint =
						<&fun_in0_qdss_6_in_tpda_qdss>;
				};
			};
		};
	};

	stm: stm@10002000 {
		compatible = "arm,coresight-stm", "arm,primecell";
		reg = <0x0 0x10002000 0x0 0x1000>,
			<0x0 0x16280000 0x0 0x180000>;
		reg-names = "stm-base", "stm-stimulus-base";
		atid = <16>;

		clocks = <&aoss_qmp>;
		clock-names = "apb_pclk";

		out-ports {
			port {
				stm_out_funnel_in0: endpoint {
					remote-endpoint =
					<&funnel_in0_in_stm>;
				};
			};
		};
	};

	fun_in0_qdss: funnel@10041000 {
		compatible = "arm,coresight-dynamic-funnel", "arm,primecell";
		reg = <0x0 0x10041000 0x0 0x1000>;
		reg-names = "funnel-base";

		device-name = "funnel_in0";

		clocks = <&aoss_qmp>;
		clock-names = "apb_pclk";
		in-ports {
			port@6 {
				reg = <6>;
				fun_in0_qdss_6_in_tpda_qdss: endpoint {
					remote-endpoint =
						<&tpda_qdss_out_fun_in0_qdss_6>;
				};
			};

			port@7 {
				reg = <7>;
				funnel_in0_in_stm: endpoint {
					remote-endpoint =
						<&stm_out_funnel_in0>;
				};
			};
		};

		out-ports {
			port {
				fun_in0_qdss_out_merge_funnel_qdss_0: endpoint {
					remote-endpoint =
						<&merge_funnel_qdss_0_in_fun_in0_qdss>;
				};
			};
		};
	};

	merge_funnel_qdss: funnel@10045000 {
		compatible = "arm,coresight-dynamic-funnel", "arm,primecell";
		reg = <0x0 0x10045000 0x0 0x1000>;
		reg-names = "funnel-base";

		device-name = "funnel_merge";

		clocks = <&aoss_qmp>;
		clock-names = "apb_pclk";

		in-ports {
			#address-cells = <1>;
			#size-cells = <0>;
			port@0 {
				reg = <0>;
				merge_funnel_qdss_0_in_fun_in0_qdss: endpoint {
					remote-endpoint =
						<&fun_in0_qdss_out_merge_funnel_qdss_0>;
				};
			};

			port@1 {
				reg = <1>;
				merge_funnel_qdss_1_in_fun_in1_qdss: endpoint {
					remote-endpoint =
						<&fun_in1_qdss_out_merge_funnel_qdss_1>;
				};
			};
		};

		out-ports {
			port {
				merge_funnel_qdss_out_aoss_7: endpoint {
					remote-endpoint =
						<&aoss_7_in_merge_funnel_qdss>;
				};
			};
		};
	};

	fun_in1_qdss: funnel@10042000 {
		compatible = "arm,coresight-dynamic-funnel", "arm,primecell";
		reg = <0x0 0x10042000 0x0 0x1000>;
		reg-names = "funnel-base";

		device-name = "funnel_in1";

		clocks = <&aoss_qmp>;
		clock-names = "apb_pclk";
		in-ports {
			#address-cells = <1>;
			#size-cells = <0>;
			port@0 {
				reg = <0>;
				fun_in1_qdss_0_in_dl_west: endpoint {
					remote-endpoint =
						<&dl_west_out_fun_in1_qdss_0>;
				};
			};

			port@1 {
				reg = <1>;
				fun_in1_qdss_1_in_tme: endpoint {
					remote-endpoint =
						<&tme_out_fun_in1_qdss_1>;
				};
			};

			port@4 {
				reg = <4>;
				fun_in1_qdss_4_in_dl_center2: endpoint {
					remote-endpoint =
						<&dl_center2_out_fun_in1_qdss_4>;
				};
			};

			port@5 {
				reg = <5>;
				fun_in1_qdss_5_in_dl_center0: endpoint {
					remote-endpoint =
						<&dl_center0_out_fun_in1_qdss_5>;
				};
			};

			port@6 {
				reg = <6>;
				fun_in1_qdss_6_in_dl_center1: endpoint {
					remote-endpoint =
						<&dl_center1_out_fun_in1_qdss_6>;
				};
			};

			port@7 {
				reg = <7>;
				fun_in1_qdss_7_in_funnel_apss: endpoint {
					remote-endpoint =
						<&funnel_apss_out_fun_in1_qdss_7>;
				};
			};
		};

		out-ports {
			port {
				fun_in1_qdss_out_merge_funnel_qdss_1: endpoint {
					remote-endpoint =
						<&merge_funnel_qdss_1_in_fun_in1_qdss>;
				};
			};
		};
	};

	qdss_repl: replicator@10046000 {
		compatible = "arm,primecell";
		arm,primecell-periphid = <0x000bb909>;
		reg = <0x0 0x10046000 0x0 0x1000>;
		reg-names = "replicator-base";

		device-name = "replicator_qdss";

		clocks = <&aoss_qmp>;
		clock-names = "apb_pclk";
		in-ports {
			port {
				qdss_repl_in_swao_repl_0: endpoint {
					remote-endpoint =
						<&swao_repl_0_out_qdss_repl>;
				};
			};
		};

		out-ports {
			port@0 {
				reg = <0>;
				qdss_repl_0_out_etr_repl: endpoint {
					remote-endpoint =
						<&etr_repl_in_qdss_repl_0>;
				};
			};
		};
	};

	etr_repl: replicator@1004e000 {
		compatible = "arm,primecell";
		arm,primecell-periphid = <0x000bb909>;
		reg = <0x0 0x1004e000 0x0 0x1000>;
		reg-names = "replicator-base";

		device-name = "replicator_etr";

		clocks = <&aoss_qmp>;
		clock-names = "apb_pclk";
		in-ports {
			port {
				etr_repl_in_qdss_repl_0: endpoint {
					remote-endpoint =
						<&qdss_repl_0_out_etr_repl>;
				};
			};
		};

		out-ports {
			#address-cells = <1>;
			#size-cells = <0>;
			port@0 {
				reg = <0>;
				etr_repl_0_out_etr: endpoint {
					remote-endpoint =
						<&etr_in_etr_repl_0>;
				};
			};

			port@1 {
				reg = <1>;
				etr_repl_1_out_replicator_dummy: endpoint {
					remote-endpoint =
						<&replicator_dummy_in_etr_repl_1>;
				};
			};
		};
	};

	etr1_replicator {
		compatible = "arm,coresight-static-replicator";

		device-name = "replicator_etr1";

		in-ports {
			port {
				replicator_dummy_in_etr_repl_1: endpoint {
					remote-endpoint =
					<&etr_repl_1_out_replicator_dummy>;
				};
			};
		};

		out-ports {
			#address-cells = <1>;
			#size-cells = <0>;

			port@0 {
				reg = <0>;
				replicator_dummy_out_tmc_modem: endpoint {
					remote-endpoint =
					<&tmc_modem_in_replicator_dummy>;
				};
			};

			port@1 {
				reg = <1>;
				replicator_dummy_out_tmc_etr1: endpoint {
					remote-endpoint =
					<&tmc_etr1_in_replicator_dummy>;
				};
			};
		};
	};

	tmc_modem: tmc-modem {
		compatible = "qcom,coresight-secure-etr";

		device-name = "modem_etr1";

		real-name = "tmc_etr1";
		qdss,buffer-size = <0x2000000>;
		qcom,secure-component;
	//	memory-region = <&qdss_apps_mem>;
		coresight-csr = <&csr>;
		csr-atid-offset = <0x108>;
		csr-irqctrl-offset = <0x70>;
		clocks = <&aoss_qmp>;
		clock-names = "apb_pclk";

		in-ports {
			port {
				tmc_modem_in_replicator_dummy: endpoint {
					remote-endpoint =
					<&replicator_dummy_out_tmc_modem>;
				};
			};
		};

		out-ports {
			port {
				tmc_modem_out_qmi: endpoint {
					remote-endpoint =
					<&qmi_in_tmc_modem>;
				};
			};
		};
	};

	etr: tmc@10048000 {
		compatible = "arm,coresight-tmc", "arm,primecell";
		reg = <0x0 0x10048000 0x0 0x1000>;
		reg-names = "tmc-base";

		device-name = "tmc_etr0";

		qcom,iommu-dma = "bypass";
		iommus = <&apps_smmu 0x00e0 0x0>;
		dma-coherent;
		arm,scatter-gather;

		qcom,sw-usb;
		coresight-csr = <&csr>;
		csr-atid-offset = <0xf8>;
		csr-irqctrl-offset = <0x6c>;
		byte-cntr-name = "byte-cntr";
		byte-cntr-class-name = "coresight-tmc-etr-stream";
		interrupts = <GIC_SPI 270 IRQ_TYPE_EDGE_RISING>;
		interrupt-names = "byte-cntr-irq";

		clocks = <&aoss_qmp>;
		clock-names = "apb_pclk";
		in-ports {
			port {
				etr_in_etr_repl_0: endpoint {
					remote-endpoint =
						<&etr_repl_0_out_etr>;
				};
			};
		};
	};

	tmc_etr1: tmc@1004f000 {
		compatible = "arm,coresight-tmc", "arm,primecell";
		reg = <0x0 0x1004f000 0x0 0x1000>;
		reg-names = "tmc-base";

		device-name = "tmc_etr1";

		iommus = <&apps_smmu 0x0100 0x0>;
		memory-region = <&tmc_etr1_region>;
		dma-coherent;
		arm,scatter-gather;

		coresight-csr = <&csr>;
		csr-atid-offset = <0x108>;
		csr-irqctrl-offset = <0x70>;
		byte-cntr-name = "byte-cntr1";
		byte-cntr-class-name = "coresight-tmc-etr1-stream";
		interrupts = <GIC_SPI 269 IRQ_TYPE_EDGE_RISING>;
		interrupt-names = "byte-cntr-irq";

		clocks = <&aoss_qmp>;
		clock-names = "apb_pclk";

		in-ports {
			port {
				tmc_etr1_in_replicator_dummy: endpoint {
					remote-endpoint =
					<&replicator_dummy_out_tmc_etr1>;
				};
			};
		};

		tmc_etr1_region: tmc_etr1_region {
			iommu-addresses = <&tmc_etr1 0x1 0x0 0xfe 0x0>;
		};
	};

	tpda_aoss: tpda@10b08000 {
		compatible = "qcom,coresight-tpda", "arm,primecell";
		reg = <0x0 0x10b08000 0x0 0x1000>;
		reg-names = "tpda-base";

		device-name = "tpda_aoss";

		clocks = <&aoss_qmp>;
		clock-names = "apb_pclk";
		in-ports {
			#address-cells = <1>;
			#size-cells = <0>;
			port@0 {
				reg = <0>;
				tpda_aoss_0_in_aoss_tpdm_swao_cmb_0: endpoint {
					remote-endpoint =
						<&aoss_tpdm_swao_cmb_0_out_tpda_aoss_0>;
				};
			};

			port@1 {
				reg = <1>;
				tpda_aoss_1_in_aoss_tpdm_swao_cmb_1: endpoint {
					remote-endpoint =
						<&aoss_tpdm_swao_cmb_1_out_tpda_aoss_1>;
				};
			};

			port@2 {
				reg = <2>;
				tpda_aoss_2_in_aoss_tpdm_swao_cmb_2: endpoint {
					remote-endpoint =
						<&aoss_tpdm_swao_cmb_2_out_tpda_aoss_2>;
				};
			};

			port@3 {
				reg = <3>;
				tpda_aoss_3_in_aoss_tpdm_swao_cmb_3: endpoint {
					remote-endpoint =
						<&aoss_tpdm_swao_cmb_3_out_tpda_aoss_3>;
				};
			};

			port@4 {
				reg = <4>;
				tpda_aoss_4_in_aoss_tpdm_swao_dsb: endpoint {
					remote-endpoint =
						<&aoss_tpdm_swao_dsb_out_tpda_aoss_4>;
				};
			};
		};

		out-ports {
			port {
				tpda_aoss_out_aoss_6: endpoint {
					remote-endpoint =
						<&aoss_6_in_tpda_aoss>;
				};
			};
		};
	};

	aoss_tpdm_swao_cmb_0: tpdm@10b09000 {
		compatible = "qcom,coresight-tpdm", "arm,primecell";
		reg = <0x0 0x10b09000 0x0 0x1000>;
		reg-names = "tpdm-base";
		qcom,cmb-element-bits = <64>;

		device-name = "tpdm_swao_prio_0";
		status = "disabled";

		clocks = <&aoss_qmp>;
		clock-names = "apb_pclk";
		out-ports {
			port {
				aoss_tpdm_swao_cmb_0_out_tpda_aoss_0: endpoint {
					remote-endpoint =
						<&tpda_aoss_0_in_aoss_tpdm_swao_cmb_0>;
				};
			};
		};
	};

	aoss_tpdm_swao_cmb_1: tpdm@10b0a000 {
		compatible = "qcom,coresight-tpdm", "arm,primecell";
		reg = <0x0 0x10b0a000 0x0 0x1000>;
		reg-names = "tpdm-base";
		qcom,cmb-element-bits = <64>;

		device-name = "tpdm_swao_prio_1";
		status = "disabled";

		clocks = <&aoss_qmp>;
		clock-names = "apb_pclk";

		out-ports {
			port {
				aoss_tpdm_swao_cmb_1_out_tpda_aoss_1: endpoint {
					remote-endpoint =
						<&tpda_aoss_1_in_aoss_tpdm_swao_cmb_1>;
				};
			};
		};
	};

	aoss_tpdm_swao_cmb_2: tpdm@10b0b000 {
		compatible = "qcom,coresight-tpdm", "arm,primecell";
		reg = <0x0 0x10b0b000 0x0 0x1000>;
		reg-names = "tpdm-base";
		qcom,cmb-element-bits = <64>;

		device-name = "tpdm_swao_prio_2";
		status = "disabled";

		clocks = <&aoss_qmp>;
		clock-names = "apb_pclk";
		out-ports {
			port {
				aoss_tpdm_swao_cmb_2_out_tpda_aoss_2: endpoint {
					remote-endpoint =
						<&tpda_aoss_2_in_aoss_tpdm_swao_cmb_2>;
				};
			};
		};
	};

	aoss_tpdm_swao_cmb_3: tpdm@10b0c000 {
		compatible = "qcom,coresight-tpdm", "arm,primecell";
		reg = <0x0 0x10b0c000 0x0 0x1000>;
		reg-names = "tpdm-base";
		qcom,cmb-element-bits = <64>;

		device-name = "tpdm_swao_prio_3";
		status = "disabled";

		clocks = <&aoss_qmp>;
		clock-names = "apb_pclk";
		out-ports {
			port {
				aoss_tpdm_swao_cmb_3_out_tpda_aoss_3: endpoint {
					remote-endpoint =
						<&tpda_aoss_3_in_aoss_tpdm_swao_cmb_3>;
				};
			};
		};
	};

	aoss_tpdm_swao_dsb: tpdm@10b0d000 {
		compatible = "qcom,coresight-tpdm", "arm,primecell";
		reg = <0x0 0x10b0d000 0x0 0x1000>;
		reg-names = "tpdm-base";
		qcom,dsb-element-bits = <32>;

		device-name = "tpdm_swao";
		status = "disabled";

		clocks = <&aoss_qmp>;
		clock-names = "apb_pclk";
		out-ports {
			port {
				aoss_tpdm_swao_dsb_out_tpda_aoss_4: endpoint {
					remote-endpoint =
						<&tpda_aoss_4_in_aoss_tpdm_swao_dsb>;
				};
			};
		};
	};

	aoss: funnel@10b04000 {
		compatible = "arm,coresight-dynamic-funnel", "arm,primecell";
		reg = <0x0 0x10b04000 0x0 0x1000>;
		reg-names = "funnel-base";

		device-name = "funnel_aoss";

		clocks = <&aoss_qmp>;
		clock-names = "apb_pclk";
		in-ports {
			#address-cells = <1>;
			#size-cells = <0>;
			port@5 {
				reg = <5>;
				aoss_5_in_funnel_lpass_lpi: endpoint {
					remote-endpoint =
					<&funnel_lpass_lpi_out_aoss_5>;
				};
			};

			port@6 {
				reg = <6>;
				aoss_6_in_tpda_aoss: endpoint {
					remote-endpoint =
						<&tpda_aoss_out_aoss_6>;
				};
			};

			port@7 {
				reg = <7>;
				aoss_7_in_merge_funnel_qdss: endpoint {
					remote-endpoint =
						<&merge_funnel_qdss_out_aoss_7>;
				};
			};
		};

		out-ports {
			port {
				aoss_out_etf_0: endpoint {
					remote-endpoint =
						<&etf_0_in_aoss>;
				};
			};
		};
	};

	etf: tmc@10b05000 {
		compatible = "arm,coresight-tmc", "arm,primecell";
		reg = <0x0 0x10b05000 0x0 0x1000>;
		reg-names = "tmc-base";

		clocks = <&aoss_qmp>;
		clock-names = "apb_pclk";
		in-ports {
			port@0 {
				etf_0_in_aoss: endpoint {
					remote-endpoint =
						<&aoss_out_etf_0>;
				};
			};
		};

		out-ports {
			port {
				etf_out_swao_repl: endpoint {
					remote-endpoint =
						<&swao_repl_in_etf>;
				};
			};
		};
	};

	swao_repl: replicator@10b06000 {
		compatible = "arm,primecell";
		arm,primecell-periphid = <0x000bb909>;
		reg = <0x0 0x10b06000 0x0 0x1000>;
		reg-names = "replicator-base";

		device-name = "replicator_swao";

		qcom,replicator-loses-context;
		clocks = <&aoss_qmp>;
		clock-names = "apb_pclk";

		in-ports {
			port {
				swao_repl_in_etf: endpoint {
					remote-endpoint =
						<&etf_out_swao_repl>;
				};
			};
		};

		out-ports {
			#address-cells = <1>;
			#size-cells = <0>;
			port@0 {
				reg = <0>;
				swao_repl_0_out_qdss_repl: endpoint {
					remote-endpoint =
						<&qdss_repl_in_swao_repl_0>;
				};
			};

			port@1 {
				reg = <1>;
				swao_repl_1_out_eud: endpoint {
					remote-endpoint =
						<&eud_in_swao_repl_1>;
				};
			};
		};
	};

	dummy_eud: dummy-eud {
		compatible = "arm,coresight-dummy-sink";

		device-name = "eud";

		in-ports {
			port {
				eud_in_swao_repl_1: endpoint {
					remote-endpoint =
						<&swao_repl_1_out_eud>;
				};
			};
		};
	};

	modem_etm0 {
		compatible = "qcom,coresight-remote-etm";

		device-name = "modem_etm0";
		qcom,atid-num = <2>;
		atid = <36 37>;
		trace-name = "modem-etm0";
		qcom,secure-component;

		out-ports {
			#address-cells = <1>;
			#size-cells = <0>;

			port@0 {
				reg = <0>;
				modem_etm0_out_funnel_modem_q6_dup: endpoint {
					remote-endpoint =
						<&funnel_modem_q6_dup_in_modem_etm0>;
				};
			};

			port@1 {
				reg = <1>;
				modem_etm0_out_qmi: endpoint {
					remote-endpoint =
						<&qmi_in_modem_etm0>;
				};
			};
		};
	};

	modem0-qmi {
		compatible = "qcom,coresight-qmi";

		device-name = "qmi_modem0";
		qcom,inst-id = <2>;

		in-ports {
			#address-cells = <1>;
			#size-cells = <0>;
			port@0 {
				reg = <0>;
				qmi_in_modem_etm0: endpoint {
					remote-endpoint =
						<&modem_etm0_out_qmi>;
				};
			};

			port@1 {
				reg = <1>;
				qmi_in_tmc_modem: endpoint {
					remote-endpoint =
						<&tmc_modem_out_qmi>;
				};
			};
		};
	};

	funnel_modem_q6_dup: funnel@1080c000 {
		compatible = "arm,primecell";
		arm,primecell-periphid = <0x000bb908>;
		reg = <0x0 0x1080d000 0x0 0x1000>,
			<0x0 0x1080c000 0x0 0x1000>;
		reg-names = "funnel-base-dummy", "funnel-base-real";

		device-name = "funnel_modem_q6_dup";

		clocks = <&aoss_qmp>;
		clock-names = "apb_pclk";
		qcom,duplicate-funnel;

		in-ports {
			port@0 {
				funnel_modem_q6_dup_in_modem_etm0: endpoint {
					remote-endpoint =
					<&modem_etm0_out_funnel_modem_q6_dup>;
				};
			};
		};

		out-ports {
			port {
				funnel_modem_q6_dup_out_funnel_modem_q6: endpoint {
					remote-endpoint =
					<&funnel_modem_q6_in_funnel_modem_q6_dup>;
				};
			};
		};
	};

	funnel_modem_q6: funnel@1080c000 {
		compatible = "arm,coresight-dynamic-funnel", "arm,primecell";
		reg = <0x0 0x1080c000 0x0 0x1000>;
		reg-names = "funnel-base";

		device-name = "funnel_modem_q6";

		clocks = <&aoss_qmp>;
		clock-names = "apb_pclk";

		in-ports {
			#address-cells = <1>;
			#size-cells = <0>;

			port@1 {
				reg = <1>;
				funnel_modem_q6_in_funnel_modem_q6_dup: endpoint {
					remote-endpoint =
					<&funnel_modem_q6_dup_out_funnel_modem_q6>;
				};
			};

			port@2 {
				reg = <2>;
				funnel_modem_q6_in_modem_diag: endpoint {
					remote-endpoint =
					<&modem_diag_out_funnel_modem_q6>;
				};
			};
		};

		out-ports {
			port {
				funnel_modem_q6_out_funnel_modem_dl: endpoint {
					remote-endpoint =
					<&funnel_modem_dl_in_funnel_modem_q6>;
				};
			};
		};
	};

	modem_diag: modem_diag {
		compatible = "arm,coresight-dummy-source";

		device-name = "modem_diag";
		atid = <50>;

		out-ports {
			port {
				modem_diag_out_funnel_modem_q6: endpoint {
					remote-endpoint =
					<&funnel_modem_q6_in_modem_diag>;
				};
			};
		};
	};

	funnel_modem_dl: funnel@10804000 {
		compatible = "arm,coresight-dynamic-funnel", "arm,primecell";
		reg = <0x0 0x10804000 0x0 0x1000>;
		reg-names = "funnel-base";

		device-name = "funnel_modem_dl";

		clocks = <&aoss_qmp>;
		clock-names = "apb_pclk";

		in-ports {

			#address-cells = <1>;
			#size-cells = <0>;

			port@0 {
				reg = <0>;
				funnel_modem_dl_in_tpda_modem: endpoint {
					remote-endpoint =
					<&tpda_modem_out_funnel_modem_dl>;
				};
			};

			port@1 {
				reg = <1>;
				funnel_modem_in_modem2_etm0: endpoint {
					remote-endpoint =
					<&modem2_etm0_out_funnel_modem>;
				};
			};

			port@3 {
				reg = <3>;
				funnel_modem_dl_in_funnel_modem_q6: endpoint {
					remote-endpoint =
					<&funnel_modem_q6_out_funnel_modem_dl>;
				};
			};
		};

		out-ports {

			port {
				modem_dl_out_dl_center0_7: endpoint {
					remote-endpoint =
					<&dl_center0_7_in__modem_dl>;
				};
			};
		};
	};

	modem2-etm0 {
		compatible = "qcom,coresight-remote-etm";

		device-name = "modem2_etm0";
		qcom,atid-num = <1>;
		atid = <39>;
		trace-name = "modem2-etm0";

		out-ports {
			#address-cells = <1>;
			#size-cells = <0>;
			port@0 {
				reg = <0>;
				modem2_etm0_out_funnel_modem: endpoint {
					remote-endpoint =
						<&funnel_modem_in_modem2_etm0>;
				};
			};

			port@1 {
				reg = <1>;
				modem2_etm0_out_qmi: endpoint {
					remote-endpoint =
						<&qmi_in_modem2_etm0>;
				};
			};
		};
	};

	modem2-qmi {
		compatible = "qcom,coresight-qmi";

		device-name = "qmi_modem2";
		qcom,inst-id = <11>;

		in-ports {
			port {
				qmi_in_modem2_etm0: endpoint {
					remote-endpoint =
						<&modem2_etm0_out_qmi>;
				};
			};
		};
	};

	tpda_modem: tpda@10803000 {
		compatible = "qcom,coresight-tpda", "arm,primecell";
		reg = <0x0 0x10803000 0x0 0x1000>;
		reg-names = "tpda-base";

		device-name = "tpda_modem";

		clocks = <&aoss_qmp>;
		clock-names = "apb_pclk";

		in-ports {
			#address-cells = <1>;
			#size-cells = <0>;

			port@0 {
				reg = <0>;
				tpda_modem_in_tpdm_modem0: endpoint {
					remote-endpoint =
					<&tpdm_modem0_out_tpda_modem>;
				};
			};

			port@1 {
				reg = <1>;
				tpda_modem_in_tpdm_modem1: endpoint {
					remote-endpoint =
					<&tpdm_modem1_out_tpda_modem>;
				};
			};

		};

		out-ports {
			port {
				tpda_modem_out_funnel_modem_dl: endpoint {
					remote-endpoint =
					<&funnel_modem_dl_in_tpda_modem>;
				};
			};
		};
	};

	tpdm_modem0: tpdm@10800000 {
		compatible = "qcom,coresight-tpdm", "arm,primecell";
		reg = <0x0 0x10800000 0x0 0x1000>;
		reg-names = "tpdm-base";
		qcom,dsb-element-bits = <32>;
		qcom,dsb-msrs-num = <16>;

		device-name = "tpdm_modem_0";
		status = "disabled";

		clocks = <&aoss_qmp>;
		clock-names = "apb_pclk";

		out-ports {
			port {
				tpdm_modem0_out_tpda_modem: endpoint {
					remote-endpoint =
					<&tpda_modem_in_tpdm_modem0>;
				};
			};
		};
	};

	tpdm_modem1: tpdm@10801000 {
		compatible = "qcom,coresight-static-tpdm";
		device-name = "tpdm_modem_1";
		qcom,cmb-element-bits = <64>;

		status = "disabled";
		out-ports {
			port {
				tpdm_modem1_out_tpda_modem: endpoint {
					remote-endpoint =
					<&tpda_modem_in_tpdm_modem1>;
				};
			};
		};
	};

	audio_etm0 {
		compatible = "qcom,coresight-remote-etm";

		device-name = "audio_etm0";
		qcom,atid-num = <2>;
		trace-name = "audio-etm0";
		atid = <40 41>;

		out-ports {
			#address-cells = <1>;
			#size-cells = <0>;
			port@0 {
				reg = <0>;
				audio_etm0_out_funnel_lpass_lpi: endpoint {
					remote-endpoint =
					<&funnel_lpass_lpi_in_audio_etm0>;
				};
			};

			port@1 {
				reg = <1>;
				audio_etm0_out_qmi: endpoint {
					remote-endpoint =
					<&qmi_in_audio_etm0>;
				};
			};
		};
	};

	lpass_stm: lpass-stm {
		compatible = "arm,coresight-dummy-source";
		device-name = "lpass_stm";
		trace-name = "lpass-stm";
		atid = <25>;

		out-ports {
			#address-cells = <1>;
			#size-cells = <0>;
			port@0 {
				reg = <0>;
				lpass_stm_out_funnel_lpass_lpi_0: endpoint {
					remote-endpoint =
					<&funnel_lpass_lpi_0_in_lpass_stm>;
				};
			};

			port@1 {
				reg = <1>;
				lpass_stm_out_qmi: endpoint {
					remote-endpoint =
					<&qmi_in_lpass_stm>;
				};
			};

		};
	};

	tpdm_lpass_lpi: tpdm@11350000 {
		compatible = "arm,coresight-dummy-source";
		device-name = "tpdm_lpass_lpi";

		trace-name = "tpda-lpass-lpi";

		status = "disabled";
		out-ports {
			#address-cells = <1>;
			#size-cells = <0>;
			port@0 {
				reg = <0>;
				tpdm_lpass_lpi_out_funnel_lpass_lpi_0: endpoint {
					remote-endpoint =
					<&funnel_lpass_lpi_0_in_tpdm_lpass_lpi>;
				};
			};

			port@1 {
				reg = <1>;
				lpass_lpi_out_qmi: endpoint {
					remote-endpoint =
					<&qmi_in_lpass_lpi>;
				};
			};
		};
	};

	funnel_lpass_lpi_0: funnel@10b44000 {
		compatible = "arm,coresight-static-funnel";
		device-name = "funnel_lpass_lpi_0";

		in-ports {
			#address-cells = <1>;
			#size-cells = <0>;

			port@0 {
				reg = <0>;
				funnel_lpass_lpi_in_audio_etm0: endpoint {
					remote-endpoint =
					<&audio_etm0_out_funnel_lpass_lpi>;
				};
			};

			port@4 {
				reg = <4>;
				funnel_lpass_lpi_0_in_lpass_stm: endpoint {
					remote-endpoint =
					<&lpass_stm_out_funnel_lpass_lpi_0>;
				};
			};

			port@5 {
				reg = <5>;
				funnel_lpass_lpi_0_in_tpdm_lpass_lpi: endpoint {
					remote-endpoint =
					<&tpdm_lpass_lpi_out_funnel_lpass_lpi_0>;
				};
			};
		};

		out-ports {
			port {
				funnel_lpass_lpi_out_aoss_5: endpoint {
					remote-endpoint =
					<&aoss_5_in_funnel_lpass_lpi>;
				};
			};
		};
	};

	audio-qmi {
		compatible = "qcom,coresight-qmi";

		device-name = "qmi-audio";
		qcom,inst-id = <5>;

		in-ports {
			#address-cells = <1>;
			#size-cells = <0>;
			port@0 {
				reg = <0>;
				qmi_in_audio_etm0: endpoint {
					remote-endpoint =
						<&audio_etm0_out_qmi>;
				};
			};

			port@1 {
				reg = <1>;
				qmi_in_lpass_stm: endpoint {
					remote-endpoint =
					<&lpass_stm_out_qmi>;
				};
			};

			port@2 {
				reg = <2>;
				qmi_in_lpass_lpi: endpoint {
					remote-endpoint =
						<&lpass_lpi_out_qmi>;
				};
			};
		};
	};

	lpass_tpdm_lpass_cx:tpdm@10844000 {
		compatible = "qcom,coresight-tpdm", "arm,primecell";
		reg = <0x0 0x10844000 0x0 0x1000>;
		reg-names = "tpdm-base";
		qcom,dsb-element-bits = <32>;
		qcom,dsb-msrs-num = <16>;

		device-name = "tpdm_lpass_cx";
		status = "disabled";

		clocks = <&aoss_qmp>;
		clock-names = "apb_pclk";
		out-ports {
			port {
				lpass_tpdm_lpass_cx_out_lpass_cx_dl_0: endpoint {
					remote-endpoint =
						<&lpass_cx_dl_0_in_lpass_tpdm_lpass_cx>;
				};
			};
		};
	};

	lpass_cx_dl: funnel@10846000 {
		compatible = "arm,coresight-dynamic-funnel", "arm,primecell";
		reg = <0x0 0x10846000 0x0 0x1000>;
		reg-names = "funnel-base";

		device-name = "funnel_cx_dl";

		clocks = <&aoss_qmp>;
		clock-names = "apb_pclk";

		in-ports {
			port@0 {
				lpass_cx_dl_0_in_lpass_tpdm_lpass_cx: endpoint {
					remote-endpoint =
						<&lpass_tpdm_lpass_cx_out_lpass_cx_dl_0>;
				};
			};
		};

		out-ports {
			port@0 {
				lpass_cx_dl_out_tpda_dlct0_0: endpoint {
					remote-endpoint =
						<&tpda_dlct0_0_in_lpass_cx_dl>;
				};
			};
		};
	};

	wpss_tpdm_wpss_tpdm_dsb: tpdm@109a0000 {
		compatible = "qcom,coresight-tpdm", "arm,primecell";
		reg = <0x0 0x109a0000 0x0 0x1000>;
		reg-names = "tpdm-base";
		qcom,dsb-element-bits = <32>;
		qcom,dsb-msrs-num = <16>;

		device-name = "tpdm_wpss";
		status = "disabled";

		clocks = <&aoss_qmp>;
		clock-names = "apb_pclk";
		out-ports {
			port {
				wpss_tpdm_wpss_tpdm_dsb_out_wpss_funnel_0: endpoint {
					remote-endpoint =
						<&wpss_funnel_0_in_wpss_tpdm_wpss_tpdm_dsb>;
				};
			};
		};
	};

	wpss_funnel: funnel@109a3000 {
		compatible = "arm,coresight-dynamic-funnel", "arm,primecell";
		reg = <0x0 0x109a3000 0x0 0x1000>;
		reg-names = "funnel-base";

		device-name = "funnel_wpss";

		clocks = <&aoss_qmp>;
		clock-names = "apb_pclk";
		in-ports {
			#address-cells = <1>;
			#size-cells = <0>;
			port@0 {
				reg = <0>;
				wpss_funnel_0_in_wpss_tpdm_wpss_tpdm_dsb: endpoint {
					remote-endpoint =
						<&wpss_tpdm_wpss_tpdm_dsb_out_wpss_funnel_0>;
				};
			};

			port@2 {
				reg = <2>;
				funnel_wpss_in_wpss_etm0: endpoint {
					remote-endpoint =
						<&wpss_etm0_out_funnel_wpss>;
				};
			};
		};

		out-ports {
			#address-cells = <1>;
			#size-cells = <0>;
			port@0 {
				reg = <0>;
				wpss_funnel_out_dl_center2_4: endpoint {
					remote-endpoint =
						<&dl_center2_4_in_wpss_funnel>;
					filter-source= <&wpss_etm>;
				};
			};

			port@1 {
				reg = <1>;
				wpss_funnel_out_tpda_dlct2_5: endpoint {
					remote-endpoint =
						<&tpda_dlct2_5_in_wpss_funnel>;
					filter-source= <&wpss_tpdm_wpss_tpdm_dsb>;
				};
			};
		};
	};

	wpss_etm: wpss_etm0 {
		compatible = "qcom,coresight-remote-etm";

		device-name = "wpss_etm0";
		qcom,inst-id = <3>;
		atid = <44>;

		out-ports {
			#address-cells = <1>;
			#size-cells = <0>;
			port@0 {
				reg = <0>;
				wpss_etm0_out_funnel_wpss: endpoint {
					remote-endpoint =
						<&funnel_wpss_in_wpss_etm0>;
				};
			};

			port@1 {
				reg = <1>;
				wpss_etm0_out_qmi: endpoint {
					remote-endpoint =
						<&qmi_in_wpss_etm0>;
				};
			};
		};
	};

	wpss-qmi {
		compatible = "qcom,coresight-qmi";

		device-name = "qmi_wpss";
		qcom,inst-id = <3>;

		in-ports {
			port {
				qmi_in_wpss_etm0: endpoint {
					remote-endpoint =
						<&wpss_etm0_out_qmi>;
				};
			};
		};
	};

	etm0 {
		compatible = "arm,primecell";
		arm,primecell-periphid = <0x000bb95d>;
		reg = <0x0 0x12040000 0x0 0x1000>;
		cpu = <&CPU0>;

		qcom,skip-power-up;

		clocks = <&aoss_qmp>;
		clock-names = "apb_pclk";

		out-ports {
			port {
				etm0_out_funnel_etm: endpoint {
				remote-endpoint = <&funnel_etm_in_etm0>;
				};
			};
		};
	};

	etm1 {
		compatible = "arm,primecell";
		arm,primecell-periphid = <0x000bb95d>;
		reg = <0x0 0x12140000 0x1000>;
		cpu = <&CPU1>;

		qcom,skip-power-up;

		clocks = <&aoss_qmp>;
		clock-names = "apb_pclk";

		out-ports {
			port {
				etm1_out_funnel_etm: endpoint {
				remote-endpoint = <&funnel_etm_in_etm1>;
				};
			};
		};
	};

	etm2 {
		compatible = "arm,primecell";
		arm,primecell-periphid = <0x000bb95d>;
		reg = <0x0 0x12240000 0x0 0x1000>;
		cpu = <&CPU2>;

		qcom,skip-power-up;
		clocks = <&aoss_qmp>;
		clock-names = "apb_pclk";

		out-ports {
			port {
				etm2_out_funnel_etm: endpoint {
				remote-endpoint = <&funnel_etm_in_etm2>;
				};
			};
		};
	};

	etm3 {
		compatible = "arm,primecell";
		arm,primecell-periphid = <0x000bb95d>;
		reg = <0x0 0x12340000 0x0 0x1000>;
		cpu = <&CPU3>;

		qcom,skip-power-up;
		clocks = <&aoss_qmp>;
		clock-names = "apb_pclk";

		out-ports {
			port {
				etm3_out_funnel_etm: endpoint {
				remote-endpoint = <&funnel_etm_in_etm3>;
				};
			};
		};
	};

	etm4 {
		compatible = "arm,primecell";
		arm,primecell-periphid = <0x000bb95d>;
		reg = <0x0 0x12440000 0x0 0x1000>;
		cpu = <&CPU4>;

		qcom,skip-power-up;
		clocks = <&aoss_qmp>;
		clock-names = "apb_pclk";

		out-ports {
			port {
				etm4_out_funnel_etm: endpoint {
				remote-endpoint = <&funnel_etm_in_etm4>;
				};
			};
		};
	};

	etm5 {
		compatible = "arm,primecell";
		arm,primecell-periphid = <0x000bb95d>;
		reg = <0x0 0x12540000 0x0 0x1000>;
		cpu = <&CPU5>;

		qcom,skip-power-up;
		clocks = <&aoss_qmp>;
		clock-names = "apb_pclk";

		out-ports {
			port {
				etm5_out_funnel_etm: endpoint {
				remote-endpoint = <&funnel_etm_in_etm5>;
				};
			};
		};
	};

	etm6 {
		compatible = "arm,primecell";
		arm,primecell-periphid = <0x000bb95d>;
		reg = <0x0 0x12640000 0x0 0x1000>;
		cpu = <&CPU6>;

		qcom,skip-power-up;
		clocks = <&aoss_qmp>;
		clock-names = "apb_pclk";

		out-ports {
			port {
				etm6_out_funnel_etm: endpoint {
				remote-endpoint = <&funnel_etm_in_etm6>;
				};
			};
		};
	};

	etm7 {
		compatible = "arm,primecell";
		arm,primecell-periphid = <0x000bb95d>;
		reg = <0x0 0x12740000 0x0 0x1000>;
		cpu = <&CPU7>;

		qcom,skip-power-up;
		clocks = <&aoss_qmp>;
		clock-names = "apb_pclk";

		out-ports {
			port {
				etm7_out_funnel_etm: endpoint {
				remote-endpoint = <&funnel_etm_in_etm7>;
				};
			};
		};
	};

	funnel_etm: funnel@12800000 {
		compatible = "arm,primecell";
		arm,primecell-periphid = <0x000bb908>;

		reg = <0x12800000 0x1000>;
		reg-names = "funnel-base";

		device-name = "funnel-etm";

		clocks = <&aoss_qmp>;
		clock-names = "apb_pclk";

		out-ports {
			port {
				funnel_etm_out_funnel_apss: endpoint {
					remote-endpoint =
					<&funnel_apss_in_funnel_etm>;
				};
			};
		};

		in-ports {
			#address-cells = <1>;
			#size-cells = <0>;

			port@0 {
				reg = <0>;
				funnel_etm_in_etm0: endpoint {
					remote-endpoint =
					<&etm0_out_funnel_etm>;
				};
			};

			port@1 {
				reg = <1>;
				funnel_etm_in_etm1: endpoint {
				remote-endpoint =
					<&etm1_out_funnel_etm>;
				};
			};

			port@2 {
				reg = <2>;
				funnel_etm_in_etm2: endpoint {
				remote-endpoint =
					<&etm2_out_funnel_etm>;
				};
			};

			port@3 {
				reg = <3>;
				funnel_etm_in_etm3: endpoint {
				remote-endpoint =
					<&etm3_out_funnel_etm>;
				};
			};

			port@4 {
				reg = <4>;
				funnel_etm_in_etm4: endpoint {
				remote-endpoint =
					<&etm4_out_funnel_etm>;
				};
			};

			port@5 {
				reg = <5>;
				funnel_etm_in_etm5: endpoint {
					remote-endpoint =
					<&etm5_out_funnel_etm>;
				};
			};

			port@6 {
				reg = <6>;
				funnel_etm_in_etm6: endpoint {
					remote-endpoint =
					<&etm6_out_funnel_etm>;
				};
			};

			port@7 {
				reg = <7>;
				funnel_etm_in_etm7: endpoint {
					remote-endpoint =
					<&etm7_out_funnel_etm>;
				};
			};
		};
	};

	funnel_apss: funnel@12810000 {
		compatible = "arm,coresight-dynamic-funnel", "arm,primecell";
		reg = <0x0 0x12810000 0x0 0x1000>;
		reg-names = "funnel-base";

		device-name = "funnel_apss";

		clocks = <&aoss_qmp>;
		clock-names = "apb_pclk";

		in-ports {
			#address-cells = <1>;
			#size-cells = <0>;

			port@0 {
				reg = <0>;
				funnel_apss_in_funnel_etm: endpoint {
					remote-endpoint =
					<&funnel_etm_out_funnel_apss>;
				};
			};

			port@3 {
				reg = <3>;
				funnel_apss_in_tpda_apss: endpoint {
					remote-endpoint =
					<&tpda_apss_out_funnel_apss>;
				};
			};
		};

		out-ports {
			port {
				funnel_apss_out_fun_in1_qdss_7: endpoint {
					remote-endpoint =
					<&fun_in1_qdss_7_in_funnel_apss>;
				};
			};
		};
	};

	tpda_apss: tpda@12863000 {
		compatible = "qcom,coresight-tpda", "arm,primecell";
		reg = <0x0 0x12863000 0x0 0x1000>;
		reg-names = "tpda-base";

		device-name = "tpda-apss";

		clocks = <&aoss_qmp>;
		clock-names = "apb_pclk";

		in-ports {
			#address-cells = <1>;
			#size-cells = <0>;

			port@0 {
				reg = <0>;
				tpda_apss_in_tpdm_llm_silver: endpoint {
					remote-endpoint =
					<&tpdm_llm_silver_out_tpda_apss>;
				};
			};

			port@1 {
				reg = <1>;
				tpda_apss_in_tpdm_llm_gold: endpoint {
					remote-endpoint =
					<&tpdm_llm_gold_out_tpda_apss>;
				};
			};

			port@3 {
				reg = <3>;
				tpda_apss_in_tpdm_int_cmb0: endpoint {
					remote-endpoint =
					<&tpdm_int_cmb0_out_tpda_apss>;
				};
			};

			port@4 {
				reg = <4>;
				tpda_apss_in_tpdm_int_dsb: endpoint {
					remote-endpoint =
					<&tpdm_int_dsb_out_tpda_apss>;
				};
			};

		};

		out-ports {
			port {
				tpda_apss_out_funnel_apss: endpoint {
					remote-endpoint =
					<&funnel_apss_in_tpda_apss>;
				};
			};
		};
	};

	tpdm_llm_silver: tpdm@128a0000 {
		compatible = "qcom,coresight-tpdm", "arm,primecell";
		reg = <0x0 0x128a0000 0x0 0x1000>;
		reg-names = "tpdm-base";
		qcom,cmb-element-bits = <32>;
		qcom,cmb-msrs-num = <12>;

		device-name = "tpdm_llm_silver";
		status = "disabled";

		clocks = <&aoss_qmp>;
		clock-names = "apb_pclk";

		out-ports {
			port {
				tpdm_llm_silver_out_tpda_apss: endpoint {
					remote-endpoint =
					<&tpda_apss_in_tpdm_llm_silver>;
				};
			};
		};
	};

	tpdm_llm_gold: tpdm@128b0000 {
		compatible = "qcom,coresight-tpdm", "arm,primecell";
		reg = <0x0 0x128b0000 0x0 0x1000>;
		reg-names = "tpdm-base";
		qcom,cmb-element-bits = <32>;
		qcom,cmb-msrs-num = <12>;

		device-name = "tpdm_llm_gold";
		status = "disabled";

		clocks = <&aoss_qmp>;
		clock-names = "apb_pclk";

		out-ports {
			port {
				tpdm_llm_gold_out_tpda_apss: endpoint {
					remote-endpoint =
					<&tpda_apss_in_tpdm_llm_gold>;
				};
			};
		};
	};

	tpdm_int_cmb0:tpdm@12860000 {
		compatible = "qcom,coresight-tpdm", "arm,primecell";
		reg = <0x0 0x12860000 0x0 0x1000>;
		reg-names = "tpdm-base";
		qcom,cmb-element-bits = <64>;
		qcom,cmb-msrs-num = <1>;

		device-name = "tpdm_int_cmb0";
		status = "disabled";

		clocks = <&aoss_qmp>;
		clock-names = "apb_pclk";

		out-ports {
			port {
				tpdm_int_cmb0_out_tpda_apss: endpoint {
					remote-endpoint =
					<&tpda_apss_in_tpdm_int_cmb0>;
				};
			};
		};
	};

	tpdm_int_dsb: tpdm@12861000 {
		compatible = "qcom,coresight-tpdm", "arm,primecell";
		reg = <0x0 0x12861000 0x0 0x1000>;
		reg-names = "tpdm-base";
		qcom,dsb-element-bits = <32>;
		qcom,dsb-msrs-num = <32>;

		device-name = "tpdm_int_dsb";
		status = "disabled";

		clocks = <&aoss_qmp>;
		clock-names = "apb_pclk";

		out-ports {
			port {
				tpdm_int_dsb_out_tpda_apss: endpoint {
					remote-endpoint =
					<&tpda_apss_in_tpdm_int_dsb>;
				};
			};
		};
	};
};
