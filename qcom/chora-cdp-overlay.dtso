// SPDX-License-Identifier: BSD-3-Clause
/*
 * Copyright (c) Qualcomm Technologies, Inc. and/or its subsidiaries.
 */

/dts-v1/;
/plugin/;

#include "chora-cdp.dtsi"
#include "chora-pmiv010x-pmd802x.dtsi"

/ {
	model = "Qualcomm Technologies, Inc. Chora CDP evros";
	compatible = "qcom,chora-cdp", "qcom,chora", "qcom,chorap-cdp", "qcom,chorap", "qcom,cdp";
	qcom,msm-id = <724 0x10000>, <744 0x10000>;
	qcom,board-id = <0x10001 0x0>;
};
