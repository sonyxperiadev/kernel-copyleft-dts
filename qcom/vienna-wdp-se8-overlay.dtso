// SPDX-License-Identifier: BSD-3-Clause
/*
 * Copyright (c) Qualcomm Technologies, Inc. and/or its subsidiaries.
 */

/dts-v1/;
/plugin/;

#include "vienna-wdp-se8.dtsi"

/ {
    model = "Qualcomm Technologies, Inc. Vienna WDP SE8";
    compatible = "qcom,vienna-wdp", "qcom,vienna", "qcom,wdp";
    qcom,board-id = <0x10024 0x02>;
};
