// SPDX-License-Identifier: BSD-3-Clause
/*
 * Copyright (c) Qualcomm Technologies, Inc. and/or its subsidiaries.
 */
/dts-v1/;
/plugin/;

#include "chora-oemvm-avf.dtsi"
#include "chora-oemvm-qrd-avf.dtsi"

/ {
	model = "Qualcomm Technologies, Inc. Chora OEMVM QRD";
	compatible = "qcom,chora-qrd", "qcom,chora", "qcom,chorap-qrd", "qcom,chorap",
			   "qcom,qrd";
	qcom,board-id = <0x1000b 0x0>, <0x2000b 0x0>;

	host {
	};
};
