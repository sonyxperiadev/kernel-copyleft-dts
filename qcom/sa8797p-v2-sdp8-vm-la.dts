// SPDX-License-Identifier: BSD-3-Clause
/*
 * Copyright (c) Qualcomm Technologies, Inc. and/or its subsidiaries.
 */

/dts-v1/;
/plugin/;

/ {
	model = "Qualcomm Technologies, Inc. SA8797p-v2 Single LA  Guest Virtual Machine";
	compatible = "qcom,sa8797p", "qcom,quinvm";
	qcom,msm-id = <690 0x20000>;
	qcom,board-id = <0x0 0x1000001>;
};

#include "sa8797p-sdp8-vm.dtsi"
#include "sa8797p-sdp8-vm-la.dtsi"

&{/} {
	model = "Qualcomm Technologies, Inc. SA8797p-v2 Single LA  Guest Virtual Machine";
	compatible = "qcom,sa8797p", "qcom,quinvm";
	qcom,msm-id = <690 0x20000>;
	qcom,board-id = <0x0 0x1000001>;
	qcom,msm-name  = "SA_QX_VM";

	#address-cells = <2>;
	#size-cells = <2>;
};

&pcie2 {
	ranges = <0x01000000 0x0 0x60000000 0x0 0x60000000 0x0 0x100000>,
		<0x02000000 0x0 0x60100000 0x0 0x60100000 0x0 0x7000000>,
		<0x43000000 0x40 0x10100000 0x40 0x10100000 0x0 0x100000>;
};

&pcie3 {
	ranges = <0x01000000 0x0 0x70000000 0x0 0x70000000 0x0 0x100000>,
		<0x02000000 0x0 0x70100000 0x0 0x70100000 0x0 0x7000000>,
		<0x43000000 0x4 0x10100000 0x4 0x10100000 0x0 0x100000>;
};
