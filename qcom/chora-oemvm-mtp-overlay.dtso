// SPDX-License-Identifier: BSD-3-Clause
/*
 * Copyright (c) Qualcomm Technologies, Inc. and/or its subsidiaries.
 */
/dts-v1/;
/plugin/;

#include "chora-oemvm-avf.dtsi"
#include "chora-oemvm-mtp-avf.dtsi"

/ {
	model = "Qualcomm Technologies, Inc. Chora OEMVM MTP";
	compatible = "qcom,chora-mtp", "qcom,chora", "qcom,chorap-mtp",
			"qcom,chorap", "qcom,mtp";
	qcom,board-id = <0x10008 0x0>, <0x20001 0x0>, <0x20008 0x0>;

	host {
	};
};
