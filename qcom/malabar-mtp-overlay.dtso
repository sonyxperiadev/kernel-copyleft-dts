// SPDX-License-Identifier: BSD-3-Clause
/*
 * Copyright (c) Qualcomm Technologies, Inc. and/or its subsidiaries.
 */

/dts-v1/;
/plugin/;

#include "malabar-mtp.dtsi"

/ {
	model = "Qualcomm Technologies, Inc. Malabar MTP";
	compatible = "qcom,malabar-mtp", "qcom,malabar", "qcom,malabarp-mtp", "qcom,malabarp",
			"qcom,mtp";
	qcom,msm-id = <733 0x10000>, <757 0x10000>;
	qcom,board-id = <0x10008 0>;
};
