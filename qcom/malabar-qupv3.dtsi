// SPDX-License-Identifier: BSD-3-Clause
/*
 * Copyright (c) Qualcomm Technologies, Inc. and/or its subsidiaries.
 */
&soc {
	qupv3_1: geniqup@4cc0000 {
		compatible = "qcom,geni-se-qup";
		reg = <0x4cc0000 0x2000>;
		#address-cells = <1>;
		#size-cells = <1>;
		clock-names = "m-ahb", "s-ahb";
		clocks = <&gcc GCC_QUPV3_WRAP_1_M_AHB_CLK>,
			 <&gcc GCC_QUPV3_WRAP_1_S_AHB_CLK>;
		ranges;
		status = "ok";

		qupv3_se8_2uart: serial@4c8c000 {
			compatible = "qcom,geni-debug-uart";
			reg = <0x4c8c000 0x4000>;
			reg-names = "se_phys";
			interrupts = <GIC_SPI 395 IRQ_TYPE_LEVEL_HIGH>;
			clock-names = "se";
			clocks = <&gcc GCC_QUPV3_WRAP1_S3_CLK>;
			pinctrl-names = "default", "sleep";
			pinctrl-0 = <&qupv3_se8_2uart_tx_active>, <&qupv3_se8_2uart_rx_active>;
			pinctrl-1 = <&qupv3_se8_2uart_sleep>;
			status = "disabled";
		};
	};
};
