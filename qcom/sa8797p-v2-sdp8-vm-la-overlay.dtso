// SPDX-License-Identifier: BSD-3-Clause
/*
 * Copyright (c) Qualcomm Technologies, Inc. and/or its subsidiaries.
 */

/dts-v1/;
/plugin/;

/ {
	model = "Qualcomm Technologies, Inc. SA8797p-v2 Single LA  Guest Virtual Machine";
	compatible = "qcom,sa8797p", "qcom,quinvm";
	qcom,msm-id = <690 0x20000>;
	qcom,board-id = <0x0 0x1000001>;
};
