// SPDX-License-Identifier: BSD-3-Clause
/*
 * Copyright (c) Qualcomm Technologies, Inc. and/or its subsidiaries.
 */

/dts-v1/;
/plugin/;

#include "alor-qrd.dtsi"

/ {
	model = "Qualcomm Technologies, Inc. Alor QRD + WCN7750 WLAN + Kundu";
	compatible = "qcom,alor-qrd", "qcom,alor", "qcom,alorp-qrd", "qcom,alorp", "qcom,qrd";
	qcom,msm-id = <685 0x10000>, <727 0x10000>;
	qcom,board-id = <0x1000B 0>;
};
