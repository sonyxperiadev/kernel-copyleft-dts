// SPDX-License-Identifier: BSD-3-Clause
/*
 * Copyright (c) Qualcomm Technologies, Inc. and/or its subsidiaries.
 */

&soc {
	walt {
		#address-cells = <1>;
		#size-cells = <1>;
		ranges;

		cycle-cntr@f521000 {
			compatible = "qcom,epss";
			reg = <0xf521000 0x1000>, <0xf523000 0x1000>;
			reg-names = "freq-domain0",
				"freq-domain1";
		};
	};
};
