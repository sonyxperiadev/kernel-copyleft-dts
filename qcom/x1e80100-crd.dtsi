// SPDX-License-Identifier: BSD-3-Clause
/*
 * Copyright (c) Qualcomm Technologies, Inc. and/or its subsidiaries.
 */

#include "x1e80100-pmic-overlay.dtsi"
#include "x1e80100-thermal-overlay.dtsi"
#include "x1-crd.dtsi"

&soc {

};
