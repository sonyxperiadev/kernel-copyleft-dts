// SPDX-License-Identifier: BSD-3-Clause
/*
 * Copyright (c) 2022-2023 Qualcomm Innovation Center, Inc. All rights reserved.
 */

#include "pineapple-cdp.dtsi"

&qupv3_se4_spi {
	status = "disabled";
};
