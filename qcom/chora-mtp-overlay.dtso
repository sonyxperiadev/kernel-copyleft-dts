// SPDX-License-Identifier: BSD-3-Clause
/*
 * Copyright (c) Qualcomm Technologies, Inc. and/or its subsidiaries.
 */

/dts-v1/;
/plugin/;

#include "chora-mtp.dtsi"
#include "chora-pmiv010x-pmd802x.dtsi"

/ {
	model = "Qualcomm Technologies, Inc. Chora MTP evros";
	compatible = "qcom,chora-mtp", "qcom,chora", "qcom,chorap-mtp", "qcom,chorap", "qcom,mtp";
	qcom,msm-id = <724 0x10000>, <744 0x10000>;
	qcom,board-id = <0x10008 0x0>;
};
