// SPDX-License-Identifier: BSD-3-Clause
/*
 * Copyright (c) Qualcomm Technologies, Inc. and/or its subsidiaries.
 */

#include <dt-bindings/interrupt-controller/irq.h>
#include <dt-bindings/spmi/spmi.h>

pmr735b: pmr735b@5 {
	compatible = "qcom,spmi-pmic";
	reg = <5 SPMI_USID>;
	#address-cells = <1>;
	#size-cells = <0>;

	pmr735b_tz: qcom,temp-alarm@a00 {
		compatible = "qcom,spmi-temp-alarm";
		reg = <0xa00>;
		interrupts = <0x5 0xa 0x0 IRQ_TYPE_EDGE_BOTH>;
		#thermal-sensor-cells = <0>;
	};

	pmr735b_gpios: pinctrl@8800 {
		compatible = "qcom,pmr735b-gpio";
		reg = <0x8800>;
		gpio-controller;
		#gpio-cells = <2>;
		interrupt-controller;
		#interrupt-cells = <2>;
	};
};
