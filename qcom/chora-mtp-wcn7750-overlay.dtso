// SPDX-License-Identifier: BSD-3-Clause
/*
 * Copyright (c) Qualcomm Technologies, Inc. and/or its subsidiaries.
 */

/dts-v1/;
/plugin/;

#include "chora-mtp.dtsi"
#include "chora-pmiv010x.dtsi"

/ {
	model = "Qualcomm Technologies, Inc. Chora MTP wcn7750";
	compatible = "qcom,chora-mtp", "qcom,chora", "qcom,chorap-mtp", "qcom,chorap", "qcom,mtp";
	qcom,msm-id = <724 0x10000>, <744 0x10000>;
	qcom,board-id = <0x20008 0x0>;
};

&pmiv010x_lcdb {
	status = "ok";
};
