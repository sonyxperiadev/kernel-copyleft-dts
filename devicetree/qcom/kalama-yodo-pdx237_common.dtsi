/* arch/arm64/boot/dts/qcom/kalama-yodo-pdx237_common.dtsi */

#include "kalama-yodo-common.dtsi"

&soc {
};

/* GPIO_159 : NC */
 /* Follow QC */

/* GPIO_160 : NC */
 /* Follow QC */

/* GPIO_161 : NC */
 /* Follow QC */

/* GPIO_186 : CS35L45_GPIO3 */
 /* Don't set here */

#include "somc-charger-yodo-common.dtsi"
#include "somc-charger-yodo-pdx237.dtsi"
#include "lxs_touchscreen_pdx234.dtsi"
#include "lxs_touchscreen_pdx237.dtsi"

&regulator_ocp_notifier {
	/delete-property/ periph-bc3-supply;
	/delete-property/ periph-bc4-supply;
	/delete-property/ periph-bc5-supply;
	/delete-property/ periph-bc6-supply;
	/delete-property/ periph-bc7-supply;
	/delete-property/ periph-d40-supply;
	/delete-property/ periph-d41-supply;
	/delete-property/ periph-d42-supply;
	/delete-property/ periph-d43-supply;
	/delete-property/ periph-d44-supply;
	/delete-property/ periph-d45-supply;
	/delete-property/ periph-d46-supply;
};
