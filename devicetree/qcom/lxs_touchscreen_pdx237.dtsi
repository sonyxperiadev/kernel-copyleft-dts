/* arch/arm64/boot/dts/qcom/lxs_touchscreen_pdx237.dtsi
 *
 * This program is free software; you can redistribute it and/or modify
 * it under the terms of the GNU General Public License version 2 and
 * only version 2 as published by the Free Software Foundation.
 *
 * This program is distributed in the hope that it will be useful,
 * but WITHOUT ANY WARRANTY; without even the implied warranty of
 * MERCHANTABILITY or FITNESS FOR A PARTICULAR PURPOSE.  See the
 * GNU General Public License for more details.
 */

&qupv3_se4_i2c  {
	sw82907@28 {
		max_x = <1080>;
		max_y = <2520>;

		// grip rejection
		lxs,rejection_area_portrait = <25 150 60 200>;
		lxs,rejection_area_landscape = <150 20 200 60>;

		/*
		 * ex) In android
		 *      /vendor/firmware/sw82907_v0.01.img
		 *      /etc/firmware/sw82907_v0.01.img
		 */
		fw_image = "touch_module_id_0x02.img";
	};
};
