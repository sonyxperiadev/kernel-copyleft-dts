/dts-v1/;
/plugin/;

#include "../qcom/lahaina-mtp-v2.dtsi"
#include "lahaina-sagami-pdx217_panel214.dtsi"

/ {
	model = "Sony Mobile Communications. PDX-217 with 214 panel(LAHAINA)";
	compatible = "somc,pdx217-panel214", "qcom,lahaina", "qcom,mtp";
	qcom,board-id = <0x20E08 0>;
};
