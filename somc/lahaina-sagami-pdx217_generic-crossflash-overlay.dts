/dts-v1/;
/plugin/;

#include "../qcom/lahaina-mtp-v2.dtsi"
#include "lahaina-sagami-pdx217_generic.dtsi"

/ {
	model = "Sony Mobile Communications. PDX-217 CrossFlash(LAHAINA)";
	compatible = "somc,pdx217-generic", "qcom,lahaina", "qcom,mtp";
	qcom,board-id = <0x20B08 0>;
};
